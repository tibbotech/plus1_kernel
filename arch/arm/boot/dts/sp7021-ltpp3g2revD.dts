// SPDX-License-Identifier: GPL-2.0
/*
 * Device Tree Source for Tibbo LTPP board G2 (Rev. D)
 *
 * Copyright (C) 2021 Sunplus Technology Co.
 */

/dts-v1/;

#include "sp7021-ltpp3g2revD.dtsi"

/ {
	model = "SP7021 LTPP3G2 Rev. D (empty sockets)";
};
