/dts-v1/;

#include "skeleton.dtsi"

#include <dt-bindings/interrupt-controller/irq.h>

/ {
	model = "Sunplus SC7021 EMU (ARM926)";
	compatible = "sunplus,sc7021-bchip";

	chosen {
		bootargs = "console=ttyS0 root=/dev/ram rw loglevel=8 earlyprintk";
	};

	memory {
		reg = <0x00000000 0x04000000>;
	};
};
