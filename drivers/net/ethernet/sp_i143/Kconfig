## drivers/net/ethernet/sp_i143/Kconfig
```kconfig
#
# Sunplus Giga Ethernet device configuration
#

config NET_VENDOR_SUNPLUS_GL2SW
	tristate "Sunplus Giga Ethernet devices"
	depends on ETHERNET
	select PHYLIB
	select PINCTRL
	select PINCTRL_SP_I143
	select RESET_CONTROLLER
	select RESET_SUNPLUS
	select NVMEM
	select NVMEM_SUNPLUS_I143_OCOTP
	---help---
	  If you have a network (Ethernet) device belonging to this class, say Y.

	  Note that the answer to this question doesn't directly affect
	  the kernel: saying N will just cause the configurator to skip all
	  the questions about Sunplus device. If you say Y, you will be asked
	  for your specific device in the following questions.

config DYNAMIC_MODE_SWITCHING_BY_SYSFS
	bool "Support Dynamic Mode-switching by sysfs"
	depends on NET_VENDOR_SUNPLUS_GL2SW
	default y
	---help---
	  This mode supports dynamic switching between two modes (by sysfs):
	      a. An NIC with daisy-chain mode
	      b. Dual NIC mode

choice
	prompt "Selected Mode"
	depends on NET_VENDOR_SUNPLUS_GL2SW
	---help---
	  Press Enter to select mode if this is not you want.

config AN_NIC_WITH_DAISY_CHAIN
	bool "An NIC with Daisy-chain Mode"
	---help---
	  This mode supports an NIC with daisy-chain support on the other port.

config DUAL_NIC
	bool "Dual NIC Mode"
	---help---
	  This mode supports dual NIC.

config AN_NIC_WITH_DAISY_CHAIN2
	bool "An NIC with Daisy-chain Mode 2"
	---help---
	  This mode supports an NIC with daisy-chain support on the other port.
	  SA learning function is turned off in this mode.

endchoice
```

## drivers/pinctrl/sp_i143/Kconfig
```kconfig
config PINCTRL_SP_I143
	bool "Sunplus i143 pinmux and gpio driver"
	depends on SOC_I143
	select PINMUX
	select GENERIC_PINCTRL_GROUPS
	select CONFIG_GENERIC_PINMUX_FUNCTIONS
	select PINCONF
	select GENERIC_PINCONF
	select OF_GPIO
	select GPIOLIB
	select GPIO_SYSFS
	select GENERIC_IRQ_CHIP
	select GPIOLIB_IRQCHIP
	help
	    Say Y here to support Sunplus i143 pinmux controller.
	    GPIO is provided by the same driver.

config PINCTRL_SP_I143_DEBUG
	bool "Sunplus i143 mux specific debug"
	depends on SOC_I143 && DEBUG_PINCTRL
	help
	    Say Y if you need to debug i143 mux driver in-depth.
```

## drivers/pinctrl/sppctl/Kconfig
```kconfig
config PINCTRL_SPPCTL
	bool "SunPlus SC7021 pinmux and gpio driver"
	depends on ARCH_PENTAGRAM
	select PINMUX
	select GENERIC_PINCTRL_GROUPS
	select CONFIG_GENERIC_PINMUX_FUNCTIONS
	select PINCONF
	select GENERIC_PINCONF
	select OF_GPIO
	select GPIOLIB
	select GPIO_SYSFS
	select GENERIC_IRQ_CHIP
	select GPIOLIB_IRQCHIP
	help
	    Say Y here to support SunPlus SC7021 pinmux controller.
	    GPIO is provided by the same driver.
```

## drivers/pinctrl/sunplus/Kconfig
```kconfig
# SPDX-License-Identifier: GPL-2.0
#
# Sunplus Pin control driver configuration
#

config PINCTRL_SPPCTL
	bool "Sunplus SP7021 pin control and GPIO driver"
	depends on SOC_SP7021
	depends on OF && HAS_IOMEM
	select PINMUX
	select GENERIC_PINCTRL_GROUPS
	select GENERIC_PINMUX_FUNCTIONS
	select PINCONF
	select GENERIC_PINCONF
	select OF_GPIO
	select GPIOLIB
	select GPIO_SYSFS
	select GENERIC_IRQ_CHIP
	select GPIOLIB_IRQCHIP
	help
	  Say Y here to support Sunplus SP7021 pin controller.
	  The driver is selected automatically by platform.
	  This driver requires the pinctrl framework.
	  GPIO is provided by the same driver.

config PINCTRL_SPPCTL_Q645
	bool "Sunplus Q645 pin control and GPIO driver"
	depends on SOC_Q645
	depends on OF && HAS_IOMEM
	select PINMUX
	select GENERIC_PINCTRL_GROUPS
	select GENERIC_PINMUX_FUNCTIONS
	select PINCONF
	select GENERIC_PINCONF
	select OF_GPIO
	select GPIOLIB
	select GPIO_SYSFS
	select GENERIC_IRQ_CHIP
	select GPIOLIB_IRQCHIP
	help
	  Say Y here to support Sunplus Q645 pin controller.
	  The driver is selected automatically by platform.
	  This driver requires the pinctrl framework.
	  GPIO is provided by the same driver.

config PINCTRL_SPPCTL_SP7350
	bool "Sunplus SP7350 pin control and GPIO driver"
	depends on SOC_SP7350
	depends on OF && HAS_IOMEM
	select PINMUX
	select GENERIC_PINCTRL_GROUPS
	select GENERIC_PINMUX_FUNCTIONS
	select PINCONF
	select GENERIC_PINCONF
	select OF_GPIO
	select GPIOLIB
	select GPIO_SYSFS
	select GENERIC_IRQ_CHIP
	select GPIOLIB_IRQCHIP
	help
	  Say Y here to support Sunplus SP7350 pin controller.
	  The driver is selected automatically by platform.
	  This driver requires the pinctrl framework.
	  GPIO is provided by the same driver.

config PINCTRL_SPPCTL_DEBUG
	bool "Sunplus pin control specific debug"
	depends on (SOC_SP7021 || SOC_Q645 || SOC_SP7350) && DEBUG_PINCTRL
	help
	  Say Y if you need to debug Sunplus pinmux driver in-depth.
	  Pin control driver will output more messages if you enable
	  this item. This function is dependent on DEBUG_PINCTRL. It
	  should be enabled first.
```

## drivers/pwm/pwm_sc7021/Kconfig
```kconfig
config PWM_SC7021
	tristate "SC7021 PWM support"
	depends on ARCH_PENTAGRAM
	help
	  Generic PWM framework driver for SC7021.

	  To compile this driver as a module, choose M here: the module
	  will be called pwm-sc7021.
```

## drivers/soc/sunplus/Kconfig
```kconfig
#
# AXI Monitor subsystem configuration
#

menu "Sunplus AXI Monitor"

config SUNPLUS_AXI_MONITOR
	tristate "Sunplus AXI monitor support"
	default n
	help
	  Sunplus breakpoint analysis of backbone-dram problem.
	  In order to speed up the breakpoint analysis of the
	  BackBone-Dram proble. Quickly locate which Master/Slave
	  caused the system to crash.

#source "drivers/soc/iop/qtest/Kconfig"
endmenu
```

## drivers/video/fbdev/fb_sc7021/Kconfig
```kconfig
config FB_SC7021
	bool "SC7021 Graphics Backend framebuffer support"
	depends on FB && ARCH_PENTAGRAM && (SP_DISP_SC7021_TEST=y)
	help
	  This is the frame buffer device driver for the SC7021 Graphics
	  hardware.

config FB_SC7021_DEBUG
	bool "External Debug support"
	depends on FB_SC7021
	help
	  Say Y here, if you want to have debug support.
```

## drivers/video/fbdev/sunplus/fb_sp7021/Kconfig
```kconfig
# SPDX-License-Identifier: GPL-2.0-or-later
config FB_SP7021
	tristate "SP7021 Graphics Backend framebuffer support"
	# depends on FB && SOC_SP7021 && VIDEO_SP7021_DISP
	default y if FB && SOC_SP7021 && VIDEO_SP7021_DISP
	select FB_CFB_FILLRECT
	select FB_CFB_COPYAREA
	select FB_CFB_IMAGEBLIT
	help
	  This is the frame buffer device driver for the SP7021
	  Graphics hardware.
	  Default y if SP7021 display driver exists.
	  SP7021 support framebuffer console.

config FB_SP7021_DEBUG
	bool "External Debug support"
	depends on FB_SP7021
	help
	  Say Y here, if you want to have debug support.
	  Debug function reserved for fb further check.
	  echo "info" > /sys/module/fb_sp7021/parameter/debug
	  can show more info for framebuffer details.
```

## drivers/video/fbdev/sunplus/fb_sp7350/Kconfig
```kconfig
# SPDX-License-Identifier: GPL-2.0
config FB_SP7350
	tristate "SP7350 framebuffer support"
	depends on FB && SOC_SP7350 && VIDEO_SP7350_DISP
	select FB_CFB_FILLRECT
	select FB_CFB_COPYAREA
	select FB_CFB_IMAGEBLIT
	help
	  Frame buffer driver for SP7350 based boards.
	  Default y if SP7350 display driver exists.
	  SP7350 support framebuffer console.

config FB_SP7350_DEBUG
	bool "External Debug support"
	depends on FB_SP7350
	help
	  Say Y here, if you want to have debug support.
	  Debug function reserved for fb further check.
	  echo "fbinfo" > /sys/module/sp7350fb/parameter/debug
	  can show more info for framebuffer details.
```
