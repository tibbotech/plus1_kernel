## Documentation/devicetree/bindings/soc/sunplus/sunplus-axi.yaml
```yaml
# SPDX-License-Identifier: (GPL-2.0-only OR BSD-2-Clause)
# Copyright (C) Sunplus Ltd. Co. 2021
%YAML 1.2
---
$id: http://devicetree.org/schemas/soc/sunplus/sunplus-axi.yaml#
$schema: http://devicetree.org/meta-schemas/core.yaml#

title: Sunplus AXI Monitor controller

maintainers:
  - tony.huang <tony.huang@sunplus.com>

description: |
  In order to speed up the breakpoint analysis of the BackBone-Dram problem.
  Quickly locate which Master/Slave caused the system crash.

properties:
  compatible:
    enum:
      - sunplus,sp7021-axi

  reg:
    items:
      - description: Global Monitor registers regions
      - description: CBDMA0_MB registers regions
      - description: CBDMA1_MB registers regions
      - description: UART2AXI_MA registers regions
      - description: NBS_MA registers regions
      - description: SPI_NOR_MA registers regions
      - description: BIO0_MA registers regions
      - description: BIO1_MA registers regions
      - description: I2C2CBUS registers regions
      - description: DARD0_MA registers regions
      - description: CARD1_MA registers regions
      - description: CARD4_MA registers regions
      - description: BR_CB registers regions
      - description: SPI_NB_SL registers regions
      - description: SPI_NOR_SL registers regions
      - description: CBDMA0_CB registers regions
      - description: CBDMA1_CB registers regions
      - description: BIO_SL registers regions
      - description: SD0_SL registers regions
      - description: CBDMA registers regions

  reg-names:
    items:
      - const: axi_mon
      - const: axi_4
      - const: axi_5
      - const: axi_12
      - const: axi_21
      - const: axi_22
      - const: axi_27
      - const: axi_28
      - const: axi_31
      - const: axi_32
      - const: axi_33
      - const: axi_34
      - const: axi_41
      - const: axi_42
      - const: axi_43
      - const: axi_45
      - const: axi_46
      - const: axi_47
      - const: axi_49
      - const: axi_cbdma

  interrupts:
    maxItems: 1

  clocks:
    minItems: 1

  resets:
    maxItems: 1

required:
  - compatible
  - reg
  - reg-names
  - interrupts
  - clocks
  - resets

additionalProperties: false

examples:
  - |
    #include <dt-bindings/interrupt-controller/irq.h>
    #include <dt-bindings/interrupt-controller/arm-gic.h>
    #include <dt-bindings/clock/sp-sp7021.h>
    #include <dt-bindings/reset/sp-sp7021.h>
    axi: axi@9c012B80 {
        compatible = "sunplus,sp7021-axi";
        reg = <0x9c012B80 0x80>, <0x9c012E00 0x80>, <0x9c012E80 0x80>,
            <0x9c013200 0x80>, <0x9c013680 0x80>, <0x9c013700 0x80>,
            <0x9c013980 0x80>, <0x9c013A00 0x80>, <0x9c013B80 0x80>,
            <0x9c013C00 0x80>, <0x9c013C80 0x80>, <0x9c013D00 0x80>,
            <0x9c014080 0x80>, <0x9c014100 0x80>, <0x9c014180 0x80>,
            <0x9c014280 0x80>, <0x9c014300 0x80>, <0x9c014380 0x80>,
            <0x9c014480 0x80>, <0x9c000D00 0x80>;
        reg-names = "axi_mon", "axi_4", "axi_5",
                "axi_12", "axi_21", "axi_22",
                "axi_27", "axi_28", "axi_31",
                "axi_32", "axi_33", "axi_34",
                "axi_41", "axi_42", "axi_43",
                "axi_45", "axi_46", "axi_47",
                "axi_49", "axi_cbdma";
        interrupt-parent = <&intc>;
        interrupts = <103 IRQ_TYPE_LEVEL_HIGH>;
        clocks = <&clkc AXI_GLOBAL>;
        resets = <&rstc RST_AXI_GLOBAL>;
    };    
...
```

## Documentation/devicetree/bindings/spi/spi-sp7021.txt
```
* Sunplus spi sp7021 controller *

Sunplus spi sp7021 controller .

Required properties:
- compatible:
 Should be "sunplus,sp7021-spi-controller":   for spi sp7021

Optional properties:
- spi-max-frequency: Maximum operating clock frequency.

- cs-gpios: see spi-bus.txt.

- spi-slave: slave mode

Example:

	spi_controller0: spi@sp_spi_controller0 {
		compatible = "sunplus,sp7021-spi-controller";
		reg = <0x9C002D80 0x80>, <0x9C002E00 0x80>;
		reg-names = "spi_master", "spi_slave";
		interrupt-parent = <&intc>;
		interrupt-names = "dma_w_intr",
			"mas_risc_intr",
			"slave_risc_intr";
		interrupts = <144 IRQ_TYPE_LEVEL_HIGH>,
			<146 IRQ_TYPE_LEVEL_HIGH>,
			<145 IRQ_TYPE_LEVEL_HIGH>;
		clocks = <&clkc SPI_COMBO_0>;
		clock-names = "sys_pll";
		resets = <&rstc RST_SPI_COMBO_0>;
	};

	&spi_controller0 {
		spi-max-frequency = <50000000>;
		pinctrl-names = "default";
		pinctrl-0 = <&pins_spim0>;
		cs-gpios = <&pctl 10 GPIO_ACTIVE_HIGH>;
		#address-cells = <1>;
		#size-cells = <0>;
		spi@0 {
			............
		};
};
```

## Documentation/devicetree/bindings/spi/spi-sunplus-sp7021.yaml
```yaml
# SPDX-License-Identifier: (GPL-2.0 OR BSD-2-Clause)
%YAML 1.2
---
$id: http://devicetree.org/schemas/i2c/spi-sunplus-sp7021.yaml#
$schema: http://devicetree.org/meta-schemas/core.yaml#

title: Sunplus sp7021 SPI  controller

allOf:
  - $ref: "spi-controller.yaml"

maintainers:
  - lh.kuo <lh.kuo@sunplus.com>


properties:
  compatible:
    oneOf:
      - enum:
          - sunplus,sp7021-spi-controller

  reg:
    minItems: 2
    maxItems: 2

  reg-names:
    minItems: 2
    maxItems: 2
    items:
      - const: spi_master
      - const: spi_slave

  interrupts-names:
    minItems: 3
    maxItems: 3
    items:
      - const: dma_w_intr
      - const: mas_risc_intr
      - const: slave_risc_intr

  interrupts:
    minItems: 3
    maxItems: 3

  clocks:
    maxItems: 1

  resets:
    maxItems: 1

  spi-max-frequency:

required:
  - compatible
  - reg
  - reg-names
  - interrupts
  - interrupts-names
  - clocks
  - resets

examples:
  - |
        spi_controller0: spi@sp_spi_controller0 {
                compatible = "sunplus,sp7021-spi-controller";
                reg = <0x9C002D80 0x80>, <0x9C002E00 0x80>;
                reg-names = "spi_master", "spi_slave";
                interrupt-parent = <&intc>;
                interrupt-names = "dma_w_intr",
                	"mas_risc_intr",
                  "slave_risc_intr";
                interrupts = <144 IRQ_TYPE_LEVEL_HIGH>,
                	<146 IRQ_TYPE_LEVEL_HIGH>,
                	<145 IRQ_TYPE_LEVEL_HIGH>;
                clocks = <&clkc SPI_COMBO_0>;
                clock-names = "sys_pll";
                resets = <&rstc RST_SPI_COMBO_0>;
        };
        &spi_controller0 {
                spi-max-frequency = <50000000>;
                pinctrl-names = "default";
                pinctrl-0 = <&pins_spim0>;
                cs-gpios = <&pctl 10 GPIO_ACTIVE_HIGH>;
        };
...
```

## Documentation/devicetree/bindings/spi/spi-sunplus.txt
```
* Sunplus spi controller *

Sunplus spi controller .

Required properties:
- compatible:
 Should be "sunplus,q645-spi-controller":   for spi q645

Optional properties:
- spi-max-frequency: Maximum operating clock frequency.

- cs-gpios: see spi-bus.txt.

- spi-slave: slave mode

Example:

	spi_controller0: spi@0xf8002c80 {
		compatible = "sunplus,q645-spi-controller";
		reg = <0x0 0xf8002c80 0x0 0x80>, <0x0 0xf8002d00 0x0 0x80>;
		reg-names = "spi_master", "spi_slave";
		interrupt-parent = <&gic>;
		interrupt-names = "dma_w_intr",
				  "mas_risc_intr",
				  "slave_risc_intr";
		interrupts = <GIC_SPI 19 IRQ_TYPE_LEVEL_HIGH>,
			     <GIC_SPI 21 IRQ_TYPE_LEVEL_HIGH>,
			     <GIC_SPI 22 IRQ_TYPE_LEVEL_HIGH>;
		clocks = <&clkc SPI_COMBO_0>;
		clock-names = "sys_pll";
		resets = <&rstc RST_SPI_COMBO_0>;
		spi-max-frequency = <50000000>;
		pinctrl-names = "default";
		pinctrl-0 = <&spim0_pins>;
		status = "disabled";
	};
```

## Documentation/devicetree/bindings/spi/spi-sunplus.yaml
```yaml
# SPDX-License-Identifier: (GPL-2.0 OR BSD-2-Clause)
%YAML 1.2
---
$id: http://devicetree.org/schemas/i2c/spi-sunplus.yaml#
$schema: http://devicetree.org/meta-schemas/core.yaml#

title: Sunplus's SPI controller

allOf:
  - $ref: "spi-controller.yaml"

maintainers:
  - lh.kuo <lh.kuo@sunplus.com>


properties:
  compatible:
    oneOf:
      - enum:
          - sunplus,q645-spi-controller

  reg:
    minItems: 2
    maxItems: 2

  reg-names:
    minItems: 2
    maxItems: 2
    items:
      - const: spi_master
      - const: spi_slave

  interrupts-names:
    minItems: 3
    maxItems: 3
    items:
      - const: dma_w_intr
      - const: mas_risc_intr
      - const: slave_risc_intr

  interrupts:
    minItems: 3
    maxItems: 3

  clocks:
    maxItems: 1

  resets:
    maxItems: 1

  spi-max-frequency:

required:
  - compatible
  - reg
  - reg-names
  - interrupts
  - interrupts-names
  - clocks
  - resets

examples:
  - |
        spi_controller0: spi@0xf8002c80 {
                compatible = "sunplus,q645-spi-controller";
                reg = <0x0 0xf8002c80 0x0 0x80>, <0x0 0xf8002d00 0x0 0x80>;
                reg-names = "spi_master", "spi_slave";
                interrupt-parent = <&intc>;
                interrupt-names = "dma_w_intr",
                	"mas_risc_intr",
                  "slave_risc_intr";
                interrupts = <GIC_SPI 19 IRQ_TYPE_LEVEL_HIGH>,
                	<GIC_SPI 21 IRQ_TYPE_LEVEL_HIGH>,
                	<GIC_SPI 22 IRQ_TYPE_LEVEL_HIGH>;
                clocks = <&clkc SPI_COMBO_0>;
                clock-names = "sys_pll";
                resets = <&rstc RST_SPI_COMBO_0>;
                spi-max-frequency = <50000000>;
                pinctrl-names = "default";
                pinctrl-0 = <&pins_spim0>;
                cs-gpios = <&pctl 10 GPIO_ACTIVE_HIGH>;
        };
...
```

## Documentation/devicetree/bindings/thermal/sunplus_thermal.txt
```
* Sunplus Thermal controller *

Sunplus thermal Controller measure the temperature on the SoC.

Required properties:
-------------------
Required properties:
- compatible:
 Should be "sunplus,sp7021-thermal":   for Thermal sp7021

Example:

		thermal: serial@sp_thermal {
			compatible = "sunplus,sp7021-thermal";
			reg = <0x9c000280 0x80>, <0x9c000200 0x80>;
			reg-names = "thermal_reg", "thermal_moon4";
			#thermal-sensor-cells = <0>;
			nvmem-cell-names = "therm_calib";
			nvmem-cells = <&therm_calib>;
		};
```

## Documentation/devicetree/bindings/thermal/sunplus_thermal.yaml
```yaml
# SPDX-License-Identifier: (GPL-2.0 OR BSD-2-Clause)
%YAML 1.2
---
$id: http://devicetree.org/schemas/thermal/sprd-thermal.yaml#
$schema: http://devicetree.org/meta-schemas/core.yaml#

title: Sunplus Thermal controller

maintainers:
  - lh.kuo <lh.kuo@sunplus.com>

allOf:
  - $ref: sunplus_thermal.yaml#

properties:
  compatible:
    enum:
      - sunplus,sp7021-thermal

  reg:
    minItems: 2
    maxItems: 2

  reg-names:
    minItems: 2
    maxItems: 2
    items:
      - const: thermal_reg
      - const: thermal_moon4

required:
  - compatible
  - reg
  - reg-names

examples:
  - |
        thermal: serial@sp_thermal {
                compatible = "sunplus,sp7021-thermal";
                reg = <0x9c000280 0x80>, <0x9c000200 0x80>;
                reg-names = "thermal_reg", "thermal_moon4";
                nvmem-cell-names = "therm_calib";
                nvmem-cells = <&therm_calib>;
        };
...
```

## Documentation/devicetree/bindings/timer/sunplus,sp-stc.txt
```
Sunplus SoC Timer

Required properties:
- compatible : Should contain entries for this and backward compatible
- reg : Offset and length of the register set for the device
- interrupt-parent : phandle to the parent interrupt controller.
- interrupts : the device's interrupt number

Example:

    timer@A_G19 {
        compatible = "sunplus,sp-stc";
        reg = <0x9ec00980 0x80>;
        interrupt-parent = <&gic>;
        interrupts = <GIC_SPI 1 IRQ_TYPE_EDGE_RISING>, /* timer0 */
                    <GIC_SPI 2 IRQ_TYPE_EDGE_RISING>, /* timer1 */
                    <GIC_SPI 3 IRQ_TYPE_EDGE_RISING>, /* timer2 */
                    <GIC_SPI 4 IRQ_TYPE_EDGE_RISING>; /* timer3 */
    };
```

## Documentation/devicetree/bindings/timer/sunplus,sp-stc.yaml
```yaml
# SPDX-License-Identifier: (GPL-2.0-only OR BSD-2-Clause)
# Copyright (C) Sunplus Co., Ltd. 2021
%YAML 1.2
---
$id: http://devicetree.org/schemas/timer/sunplus,sp-stc.yaml#
$schema: http://devicetree.org/meta-schemas/core.yaml#

title: Sunplus SoC Timers Bindings

maintainers:
  - Qin Jian <qinjian@cqplus1.com>

properties:
  compatible:
    const: sunplus,sp-stc

  reg:
    maxItems: 1

  interrupts:
    maxItems: 4

required:
  - compatible
  - reg
  - interrupts

additionalProperties: false

examples:
  - |
    #include <dt-bindings/interrupt-controller/arm-gic.h>

    timer@9ec00980 {
      compatible = "sunplus,sp-stc";
      reg = <0x9ec00980 0x80>;
      interrupt-parent = <&gic>;
      interrupts = <GIC_SPI 1 IRQ_TYPE_EDGE_RISING>, /* timer0 */
                   <GIC_SPI 2 IRQ_TYPE_EDGE_RISING>, /* timer1 */
                   <GIC_SPI 3 IRQ_TYPE_EDGE_RISING>, /* timer2 */
                   <GIC_SPI 4 IRQ_TYPE_EDGE_RISING>; /* timer3 */
    };

...
```

## Documentation/devicetree/bindings/usb/ehci-sunplus.txt
```
Device-Tree bindings of sp_ehci0/sp_ehci1 device

Required properties:
- compatible: Should be
				"sunplus,sp7021-usb-ehci0" for sp_ehci0 of sp7021
				"sunplus,sp7021-usb-ehci1" for sp_ehci1 of sp7021
				"sunplus,q645-usb-ehci0" for sp_ehci0 of q645
- clocks: Clock phandles (see clock-controller for details)
- resets: Reset phandles (see reset-controller for details)
- reg: Physical base address and length of the controller's register
- interrupt-parent: Interrupt phandles (see interrupt-controller for details)
- interrupts: interrupt number to the cpu.

Example:

	sp_ehci0: usb@0x9C102100 {
		compatible = "sunplus,sp7021-usb-ehci0";
		clocks = <&clkc USBC0>;
		resets = <&rstc RST_USBC0>;
		reg = <0x9C102100 0x68>;
		interrupt-parent = <&intc>;
		interrupts = <14 IRQ_TYPE_LEVEL_HIGH>;
	};

	sp_ehci1: usb@0x9C103100 {
		compatible = "sunplus,sp7021-usb-ehci1";
		clocks = <&clkc USBC1>;
		resets = <&rstc RST_USBC1>;
		reg = <0x9C103100 0x68>;
		interrupt-parent = <&intc>;
		interrupts = <17 IRQ_TYPE_LEVEL_HIGH>;
	};
```

## Documentation/devicetree/bindings/usb/ohci-sunplus.txt
```
Device-Tree bindings of sp_ohci0/sp_ohci1 device

Required properties:
- compatible: Should be
				"sunplus,sp7021-usb-ohci0" for sp_ohci0 of sp7021
				"sunplus,sp7021-usb-ohci1" for sp_ohci1 of sp7021
				"sunplus,q645-usb-ohci0" for sp_ohci0 of q645
- clocks: Clock phandles (see clock-controller for details)
- resets: Reset phandles (see reset-controller for details)
- reg: Physical base address and length of the controller's register
- interrupt-parent: Interrupt phandles (see interrupt-controller for details)
- interrupts: interrupt number to the cpu.

Example:

	sp_ohci0: usb@0x9C102080 {
		compatible = "sunplus,sp7021-usb-ohci0";
		clocks = <&clkc USBC0>;
		resets = <&rstc RST_USBC0>;
		reg = <0x9C102080 0x68>, <0x9C000000 0x80>;
		interrupt-parent = <&intc>;
		interrupts = <15 IRQ_TYPE_LEVEL_HIGH>;
	};

	sp_ohci1: usb@0x9C103080 {
		compatible = "sunplus,sp7021-usb-ohci1";
		clocks = <&clkc USBC1>;
		resets = <&rstc RST_USBC1>;
		reg = <0x9C103080 0x68>, <0x9C000000 0x80>;
		interrupt-parent = <&intc>;
		interrupts = <18 IRQ_TYPE_LEVEL_HIGH>;
	};
```
