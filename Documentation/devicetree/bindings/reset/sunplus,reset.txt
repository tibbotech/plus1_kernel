## Documentation/devicetree/bindings/usb/sunplus,sp7021-usb-ehci.yaml
```yaml
# SPDX-License-Identifier: (GPL-2.0-only OR BSD-2-Clause)
# Copyright (C) Sunplus Co., Ltd. 2021
%YAML 1.2
---
$id: http://devicetree.org/schemas/usb/sunplus,sp7021-usb-ehci.yaml#
$schema: http://devicetree.org/meta-schemas/core.yaml#

title: Sunplus SP7021 EHCI Device Tree bindings for port0/port1

maintainers:
  - Vincent Shih <vincent.shih@sunplus.com>

allOf:
  - $ref: usb-hcd.yaml#

properties:
  compatible:
    enum:
      - sunplus,sp7021-usb-ehci0
      - sunplus,sp7021-usb-ehci1

  clocks:
    maxItems: 1

  resets:
    maxItems: 1

  reg:
    maxItems: 1

  interrupts:
    maxItems: 1

required:
  - compatible
  - clocks
  - resets
  - reg
  - interrupts

additionalProperties: false

examples:
  - |
    #include <dt-bindings/clock/sp-sp7021.h>
    #include <dt-bindings/reset/sp-sp7021.h>
    #include <dt-bindings/interrupt-controller/irq.h>

    sp_ehci0: usb@9C102100 {
      compatible = "sunplus,sp7021-usb-ehci0";
      clocks = <&clkc USBC0>;
      resets = <&rstc RST_USBC0>;
      reg = <0x9C102100 0x68>;
      interrupt-parent = <&intc>;
      interrupts = <14 IRQ_TYPE_LEVEL_HIGH>;
    };

    sp_ehci1: usb@9C103100 {
      compatible = "sunplus,sp7021-usb-ehci1";
      clocks = <&clkc USBC1>;
      resets = <&rstc RST_USBC1>;
      reg = <0x9C103100 0x68>;
      interrupt-parent = <&intc>;
      interrupts = <17 IRQ_TYPE_LEVEL_HIGH>;
    };
...
```

## Documentation/devicetree/bindings/usb/sunplus,sp7021-usb-ohci.yaml
```yaml
# SPDX-License-Identifier: (GPL-2.0-only OR BSD-2-Clause)
# Copyright (C) Sunplus Co., Ltd. 2021
%YAML 1.2
---
$id: http://devicetree.org/schemas/usb/sunplus,sp7021-usb-ohci.yaml#
$schema: http://devicetree.org/meta-schemas/core.yaml#

title: Sunplus SP7021 OHCI Device Tree bindings for port0/port1

maintainers:
  - Vincent Shih <vincent.shih@sunplus.com>

allOf:
  - $ref: usb-hcd.yaml#

properties:
  compatible:
    enum:
      - sunplus,sp7021-usb-ohci0
      - sunplus,sp7021-usb-ohci1

  clocks:
    maxItems: 1

  resets:
    maxItems: 1

  reg:
    maxItems: 2

  interrupts:
    maxItems: 1

required:
  - compatible
  - clocks
  - resets
  - reg
  - interrupts

additionalProperties: false

examples:
  - |
    #include <dt-bindings/clock/sp-sp7021.h>
    #include <dt-bindings/reset/sp-sp7021.h>
    #include <dt-bindings/interrupt-controller/irq.h>

    sp_ohci0: usb@9C102080 {
      compatible = "sunplus,sp7021-usb-ohci0";
      clocks = <&clkc USBC0>;
      resets = <&rstc RST_USBC0>;
      reg = <0x9C102080 0x68>, <0x9C000000 0x80>;
      interrupt-parent = <&intc>;
      interrupts = <15 IRQ_TYPE_LEVEL_HIGH>;
    };

    sp_ohci1: usb@9C103080 {
      compatible = "sunplus,sp7021-usb-ohci1";
      clocks = <&clkc USBC1>;
      resets = <&rstc RST_USBC1>;
      reg = <0x9C103080 0x68>, <0x9C000000 0x80>;
      interrupt-parent = <&intc>;
      interrupts = <18 IRQ_TYPE_LEVEL_HIGH>;
    };
...
```

## Documentation/devicetree/bindings/usb/sunplus,sp7021-usb-otg.yaml
```yaml
# SPDX-License-Identifier: (GPL-2.0-only OR BSD-2-Clause)
# Copyright (C) Sunplus Co., Ltd. 2021
%YAML 1.2
---
$id: http://devicetree.org/schemas/usb/sunplus,sp7021-usb-otg.yaml#
$schema: http://devicetree.org/meta-schemas/core.yaml#

title: Sunplus SP7021 OTG Device Tree bindings for port0/port1

maintainers:
  - Vincent Shih <vincent.shih@sunplus.com>

allOf:
  - $ref: usb-hcd.yaml#

properties:
  compatible:
    enum:
      - sunplus,sp7021-usb-otg0
      - sunplus,sp7021-usb-otg1

  reg:
    maxItems: 2

  interrupts:
    maxItems: 1

required:
  - compatible
  - reg
  - interrupts

additionalProperties: false

examples:
  - |
    #include <dt-bindings/interrupt-controller/irq.h>

    sp_otg0: usb@9c102400 {
      compatible = "sunplus,sp7021-usb-otg0";
      reg = <0x9c102400 0x70>, <0x9c000200 0x80>;
      interrupt-parent = <&intc>;
      interrupts = <11 IRQ_TYPE_LEVEL_HIGH>;
    };

    sp_otg1: usb@9c103400 {
      compatible = "sunplus,sp7021-usb-otg1";
      reg = <0x9c103400 0x70>, <0x9c000200 0x80>;
      interrupt-parent = <&intc>;
      interrupts = <10 IRQ_TYPE_LEVEL_HIGH>;
    };
...
```

## Documentation/devicetree/bindings/usb/sunplus,sp7021-usb-udc.yaml
```yaml
# SPDX-License-Identifier: (GPL-2.0-only OR BSD-2-Clause)
# Copyright (C) Sunplus Co., Ltd. 2021
%YAML 1.2
---
$id: http://devicetree.org/schemas/usb/sunplus,sp7021-usb-udc.yaml#
$schema: http://devicetree.org/meta-schemas/core.yaml#

title: Sunplus SP7021 UDC Device Tree bindings for port0/port1

maintainers:
  - Vincent Shih <vincent.shih@sunplus.com>

allOf:
  - $ref: usb-hcd.yaml#

properties:
  compatible:
    enum:
      - sunplus,sp7021-usb-udc0
      - sunplus,sp7021-usb-udc1

  clocks:
    maxItems: 1

  resets:
    maxItems: 1

  reg:
    maxItems: 1

  interrupts:
    maxItems: 1

required:
  - compatible
  - clocks
  - resets
  - reg
  - interrupts

additionalProperties: false

examples:
  - |
    #include <dt-bindings/clock/sp-sp7021.h>
    #include <dt-bindings/reset/sp-sp7021.h>
    #include <dt-bindings/interrupt-controller/irq.h>

    sp_udc0: usb@9c102800 {
      compatible = "sunplus,sp7021-usb-udc0";
      clocks = <&clkc USBC0>;
      resets = <&rstc RST_USBC0>;
      reg = <0x9c102800 0x400>;
      interrupt-parent = <&intc>;
      interrupts = <13 IRQ_TYPE_LEVEL_HIGH>;
    };

    sp_udc1: usb@9c103800 {
      compatible = "sunplus,sp7021-usb-udc1";
      clocks = <&clkc USBC1>;
      resets = <&rstc RST_USBC1>;
      reg = <0x9c103800 0x400>;
      interrupt-parent = <&intc>;
      interrupts = <16 IRQ_TYPE_LEVEL_HIGH>;
    };
...
```

## Documentation/devicetree/bindings/usb/sunplus-otg.txt
```
Device-Tree bindings of sp_otg0/sp_otg1 device

Required properties:
- compatible: Should be
				"sunplus,sp7021-usb-otg0" for sp_otg0 of sp7021
				"sunplus,sp7021-usb-otg1" for sp_otg1 of sp7021
- reg: Physical base address and length of the controller's register
- interrupt-parent: Interrupt phandles (see interrupt-controller for details)
- interrupts: interrupt number to the cpu.

Example:

	sp_otg0: usb@0x9c102400 {
			compatible = "sunplus,sp7021-usb-otg0";
			reg = <0x9c102400 0x70>, <0x9c000200 0x80>;
			interrupt-parent = <&intc>;
			interrupts = <11 IRQ_TYPE_LEVEL_HIGH>;
		};

	sp_otg1: usb@0x9c103400 {
		compatible = "sunplus,sp7021-usb-otg1";
		reg = <0x9c103400 0x70>, <0x9c000200 0x80>;
		interrupt-parent = <&intc>;
		interrupts = <10 IRQ_TYPE_LEVEL_HIGH>;
	};
```

## Documentation/devicetree/bindings/usb/sunplus-udc.txt
```
Device-Tree bindings of sp_udc0/sp_udc1 device

Required properties:
- compatible: Should be
				"sunplus,sp7021-usb-udc0" for sp_udc0 of sp7021
				"sunplus,sp7021-usb-udc1" for sp_udc1 of sp7021
- clocks: Clock phandles (see clock-controller for details)
- resets: Reset phandles (see reset-controller for details)
- reg: Physical base address and length of the controller's register
- interrupt-parent: Interrupt phandles (see interrupt-controller for details)
- interrupts: interrupt number to the cpu.

Example:

	sp_udc0: usb@0x9c102800 {
		compatible = "sunplus,sp7021-usb-udc0";
		clocks = <&clkc USBC0>;
		resets = <&rstc RST_USBC0>;
		reg = <0x9c102800 0x400>;
		interrupt-parent = <&intc>;
		interrupts = <13 IRQ_TYPE_LEVEL_HIGH>;
	};

	sp_udc1: usb@0x9c103800 {
		compatible = "sunplus,sp7021-usb-udc1";
		clocks = <&clkc USBC1>;
		resets = <&rstc RST_USBC1>;
		reg = <0x9c103800 0x400>;
		interrupt-parent = <&intc>;
		interrupts = <16 IRQ_TYPE_LEVEL_HIGH>;
	};
```

## Documentation/devicetree/bindings/watchdog/sunplus,wdt.yaml
```yaml
# SPDX-License-Identifier: (GPL-2.0-only OR BSD-2-Clause)
# Copyright (C) Sunplus Co., Ltd. 2021
%YAML 1.2
---
$id: "http://devicetree.org/schemas/watchdog/sunplus,wdt.yaml#"
$schema: "http://devicetree.org/meta-schemas/core.yaml#"

title: Sunplus SoCs Watchdog timer

maintainers:
  - XianTao Hu <xt.hu@cqplus1.com>

allOf:
  - $ref: watchdog.yaml#

properties:
  compatible:
    enum:
      - sunplus,sp7021-wdt
      - sunplus,q645-wdt

  reg:
    maxItems: 2

  clocks:
    maxItems: 1

  resets:
    maxItems: 1

additionalProperties: false

required:
  - compatible
  - reg
  - clocks
  - resets

examples:
  - |
    #include <dt-bindings/clock/sp-sp7021.h>
    #include <dt-bindings/reset/sp-sp7021.h>
    watchdog: watchdog@9c000630 {
        compatible = "sunplus,sp7021-wdt";
        reg = <0x9c000630 0x08>, <0x9C000274 0x04>;
        clocks = <&clkc STC0>;
        resets = <&rstc RST_STC0>;
    };
...
```
