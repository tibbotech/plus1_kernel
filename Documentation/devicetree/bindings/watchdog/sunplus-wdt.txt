## arch/arm64/configs/sp7350_nor_c_ev_defconfig
```kconfig
CONFIG_LOCALVERSION="-SUNPLUS-v8"
# CONFIG_LOCALVERSION_AUTO is not set
CONFIG_DEFAULT_HOSTNAME="SP7350-Ev"
CONFIG_CROSS_COMPILE="aarch64-none-linux-gnu-"
CONFIG_SYSVIPC=y
# CONFIG_CROSS_MEMORY_ATTACH is not set
# CONFIG_FHANDLE is not set
CONFIG_IRQ_DOMAIN_DEBUG=y
CONFIG_NO_HZ_IDLE=y
CONFIG_HIGH_RES_TIMERS=y
CONFIG_VIRT_CPU_ACCOUNTING_GEN=y
CONFIG_BSD_PROCESS_ACCT=y
CONFIG_BSD_PROCESS_ACCT_V3=y
CONFIG_LOG_BUF_SHIFT=18
CONFIG_CGROUPS=y
CONFIG_CGROUPS_SCHED=y
CONFIG_CFS_BANDWIDTH=y
CONFIG_CGROUP_PIDS=y
CONFIG_CGROUP_FREEZER=y
CONFIG_CPUSETS=y
CONFIG_CGROUP_DEVICE=y
CONFIG_CGROUP_CPUACCT=y
# CONFIG_RD_GZIP is not set
# CONFIG_RD_BZIP2 is not set
# CONFIG_RD_LZMA is not set
# CONFIG_RD_XZ is not set
# CONFIG_RD_LZO is not set
# CONFIG_RD_LZ4 is not set
CONFIG_SGETMASK_SYSCALL=y
CONFIG_SYSCTL_SYSCALL=y
CONFIG_KALLSYMS_ALL=y
CONFIG_USERFAULTFD=y
CONFIG_EMBEDDED=y
# CONFIG_SLUB_DEBUG is not set
CONFIG_JUMP_LABEL=y
CONFIG_CC_STACKPROTECTOR_STRONG=y
CONFIG_BLOCK=y
CONFIG_SCSI=y
CONFIG_BLK_DEV_SD=y
CONFIG_USB=y
CONFIG_USB_XHCI_HCD=y
CONFIG_USB_STORAGE=y

CONFIG_SOC_SP7350=y

CONFIG_SCHED_MC=y
CONFIG_SCHED_SMT=y
CONFIG_NR_CPUS=4
CONFIG_HOTPLUG_CPU=y
CONFIG_HZ_1000=y
CONFIG_KSM=y
CONFIG_DEFAULT_MMAP_MIN_ADDR=65536
CONFIG_TRANSPARENT_HUGEPAGE=y
CONFIG_TRANSPARENT_HUGEPAGE_MADVISE=y
CONFIG_CLEANCACHE=y
CONFIG_ZPOOL=y
CONFIG_ZBUD=y
CONFIG_ZSMALLOC=y
CONFIG_PGTABLE_MAPPING=y
CONFIG_IDLE_PAFE_TRACKING=y
CONFIG_SECCOMP=y
CONFIG_PARAVIRT=y
# CONFIG_ARM64_VHE is not set
# CONFIG_EFI is not set
# CONFIG_CORE_DUMP_DEFAULT_ELF_HEADERS is not set
CONFIG_PM=y
CONFIG_UNIX=y
CONFIG_UEVENT_HELPER=y
CONFIG_DEVTMPFS=y
CONFIG_DEVTMPFS_MOUNT=y
CONFIG_MTD=y
CONFIG_MTD_CMDLINE_PARTS=y
CONFIG_MTD_BLOCK=y
CONFIG_MTD_SPI_NOR=y
# CONFIG_MTD_SPI_NOR_USE_4K_SECTORS is not set
CONFIG_SPI_SUNPLUS_SPI=y
CONFIG_SPI=y
# CONFIG_STANDALONE is not set
CONFIG_INPUT_FF_MEMLESS=y
CONFIG_INPUT_POLLDEV=y
CONFIG_INPUT_EVDEV=y
# CONFIG_LEGACY_PTYS is not set
CONFIG_RTC_CLASS=y
CONFIG_SYNC_FILE=y
CONFIG_SW_SYNC=y
CONFIG_NVMEM_SUNPLUS_OCOTP=y
#CONFIG_FUSE_FS=y
CONFIG_PROC_KCORE=y
CONFIG_TMPFS=y
CONFIG_MSDOS_FS=y
CONFIG_VFAT_FS=y
CONFIG_FAT_DEFAULT_IOCHARSET="utf8"
CONFIG_FAT_DEFAULT_UTF8=y
CONFIG_MISC_FILESYSTEMS=y
CONFIG_JFFS2_FS=y
CONFIG_NLS=y
CONFIG_NLS_DEFAULT="utf8"
CONFIG_NLS_CODEPAGE_437=y
CONFIG_NLS_ASCII=y
CONFIG_NLS_ISO8859_1=y
CONFIG_NLS_UTF8=y
CONFIG_PRINTK_TIME=y
CONFIG_BOOT_PRINTK_DELAY=y
CONFIG_DYNAMIC_DEBUG=y
CONFIG_DEBUG_FS=y
CONFIG_DEBUG_INFO=y
CONFIG_DEBUG_INFO_DWARF4=y
CONFIG_GDB_SCRIPTS=y
# CONFIG_ENABLE_WARN_DEPRECATED is not set
# CONFIG_ENABLE_MUST_CHECK is not set
CONFIG_FRAME_WARN=1024
CONFIG_UNUSED_SYMBOLS=y
CONFIG_MAGIC_SYSRQ=y
CONFIG_MAIGC_SYSRQ_DEFAULT_ENABLE=0x01b6
CONFIG_LOCKUP_DETECTOR=y
CONFIG_RCU_CPU_STALL_TIMEOUT=60
CONFIG_ARM64_PTDUMP=y
#CONFIG_MALI_MIDGARD=y
CONFIG_MALI_PLATFORM_NAME="candy"
CONFIG_COMPAT=y
CONFIG_KUSER_HELPERS=y
CONFIG_ARMV8_DEPRECATED=y
CONFIG_SWP_EMULATION=y
CONFIG_CP15_BARRIER_EMULATION=y
CONFIG_SETEND_EMULATION=y
CONFIG_BINFMT_ELF=y
CONFIG_COMPAT_BINFMT_ELF=y
CONFIG_PINCTRL=y
CONFIG_PINCTRL_SPPCTL_SP7350=y
CONFIG_REMOTEPROC=y
CONFIG_SUNPLUS_REMOTEPROC=y
CONFIG_RPMSG_CHAR=y
CONFIG_RPMSG_TTY=y
CONFIG_BINFMT_SCRIPT=y
CONFIG_TEE=y
CONFIG_OPTEE=y
#
# DMA Devices
#
CONFIG_DMA_ENGINE=y
CONFIG_DMA_OF=y
CONFIG_DW_DMAC_CORE=y
CONFIG_DW_DMAC=y
# SPI Master Controller Drivers
# CONFIG_SPI_DEBUG is not set
CONFIG_SPI=y
CONFIG_SPI_SPIDEV=y
CONFIG_SPI_SLAVE=y
CONFIG_SPI_MASTER=y
CONFIG_SPI_MEM=y
CONFIG_SPI_DESIGNWARE=y
CONFIG_SPI_DW_DMA=y
CONFIG_SPI_DW_MMIO=y
#
# I2C support
#
CONFIG_I2C=y
CONFIG_I2C_CHARDEV=y
CONFIG_I2C_DESIGNWARE_CORE=y
CONFIG_I2C_DESIGNWARE_SLAVE=y
CONFIG_I2C_DESIGNWARE_PLATFORM=y
#
# IIO ADC support
#
CONFIG_REGMAP_IRQ=y
CONFIG_IIO=y
CONFIG_IIO_BUFFER=y
CONFIG_IIO_CONFIGFS=y
CONFIG_IIO_TRIGGER=y
CONFIG_IIO_CONSUMERS_PER_TRIGGER=2
CONFIG_IIO_SW_DEVICE=y
CONFIG_IIO_SW_TRIGGER=y
CONFIG_IIO_TRIGGERED_EVENT=y

CONFIG_SUNPLUS_ADC=y
CONFIG_CONFIGFS_FS=y
```

## arch/arm64/configs/sp7350_romter_c_ev_defconfig
```kconfig
CONFIG_LOCALVERSION="-SUNPLUS-v8"
# CONFIG_LOCALVERSION_AUTO is not set
CONFIG_DEFAULT_HOSTNAME="SP7350-Ev"
CONFIG_CROSS_COMPILE="aarch64-none-linux-gnu-"
CONFIG_SYSVIPC=y
# CONFIG_CROSS_MEMORY_ATTACH is not set
# CONFIG_FHANDLE is not set
CONFIG_IRQ_DOMAIN_DEBUG=y
CONFIG_NO_HZ_IDLE=y
CONFIG_HIGH_RES_TIMERS=y
CONFIG_VIRT_CPU_ACCOUNTING_GEN=y
CONFIG_BSD_PROCESS_ACCT=y
CONFIG_BSD_PROCESS_ACCT_V3=y
CONFIG_LOG_BUF_SHIFT=18
CONFIG_CGROUPS=y
CONFIG_CGROUP_SCHED=y
CONFIG_CFS_BANDWIDTH=y
CONFIG_CGROUP_PIDS=y
CONFIG_CGROUP_FREEZER=y
CONFIG_CPUSETS=y
CONFIG_CGROUP_DEVICE=y
CONFIG_CGROUP_CPUACCT=y
CONFIG_BLK_DEV_INITRD=y
CONFIG_INITRAMFS_SOURCE="../rootfs/initramfs/disk/ ../rootfs/initramfs/initramfs.devnodes"
CONFIG_INITRAMFS_ROOT_UID=-1
CONFIG_INITRAMFS_ROOT_GID=-1
# CONFIG_RD_GZIP is not set
# CONFIG_RD_BZIP2 is not set
# CONFIG_RD_LZMA is not set
# CONFIG_RD_XZ is not set
# CONFIG_RD_LZO is not set
# CONFIG_RD_LZ4 is not set
CONFIG_SGETMASK_SYSCALL=y
CONFIG_SYSCTL_SYSCALL=y
CONFIG_KALLSYMS_ALL=y
CONFIG_USERFAULTFD=y
CONFIG_EMBEDDED=y
# CONFIG_SLUB_DEBUG is not set
CONFIG_JUMP_LABEL=y
CONFIG_CC_STACKPROTECTOR_STRONG=y
CONFIG_BLOCK=y
CONFIG_SCSI=y
CONFIG_BLK_DEV_SD=y
CONFIG_SCHED_MC=y
CONFIG_SCHED_SMT=y
CONFIG_NR_CPUS=4
CONFIG_HOTPLUG_CPU=y
CONFIG_HZ_1000=y
CONFIG_KSM=y
CONFIG_DEFAULT_MMAP_MIN_ADDR=65536
CONFIG_TRANSPARENT_HUGEPAGE=y
CONFIG_TRANSPARENT_HUGEPAGE_MADVISE=y
CONFIG_CLEANCACHE=y
CONFIG_ZPOOL=y
CONFIG_ZBUD=y
CONFIG_ZSMALLOC=y
CONFIG_PGTABLE_MAPPING=y
CONFIG_IDLE_PAFE_TRACKING=y
CONFIG_SECCOMP=y
CONFIG_PARAVIRT=y
# CONFIG_ARM64_VHE is not set
# CONFIG_EFI is not set
CONFIG_MODULES=y
CONFIG_MODULE_UNLOAD=y
CONFIG_MODVERSIONS=y
# CONFIG_CORE_DUMP_DEFAULT_ELF_HEADERS is not set
CONFIG_NET=n
CONFIG_PACKET=y
CONFIG_PACKET_DIAG=y
CONFIG_UNIX=y
CONFIG_INET=y
CONFIG_IP_MULTICAST=y
CONFIG_IP_PNP=y
CONFIG_IP_PNP_DHCP=y
CONFIG_IP_PNP_BOOTP=y
CONFIG_IP_PNP_RARP=y
CONFIG_NET_IPIP=m
CONFIG_NETLINK_DIAG=y
CONFIG_UEVENT_HELPER=y
CONFIG_DEVTMPFS=y
CONFIG_DEVTMPFS_MOUNT=y
CONFIG_NETDEVICES=y
# CONFIG_NET_VENDOR_ALACRITECH is not set
# CONFIG_NET_VENDOR_AMAZON is not set
# CONFIG_NET_VENDOR_AMD is not set
# CONFIG_NET_VENDOR_AQUANTIA is not set
# CONFIG_NET_VENDOR_ARC is not set
# CONFIG_NET_VENDOR_AURORA is not set
# CONFIG_NET_VENDOR_BROADCOM is not set
# CONFIG_NET_VENDOR_CADENCE is not set
# CONFIG_NET_VENDOR_CAVIUM is not set
# CONFIG_NET_VENDOR_CIRRUS is not set
# CONFIG_NET_VENDOR_CORTINA is not set
# CONFIG_NET_VENDOR_EZCHIP is not set
# CONFIG_NET_VENDOR_FARADAY is not set
# CONFIG_NET_VENDOR_GOOGLE is not set
# CONFIG_NET_VENDOR_HISILICON is not set
# CONFIG_NET_VENDOR_HUAWEI is not set
# CONFIG_NET_VENDOR_INTEL is not set
# CONFIG_NET_VENDOR_MARVELL is not set
# CONFIG_NET_VENDOR_MELLANOX is not set
# CONFIG_NET_VENDOR_MICREL is not set
# CONFIG_NET_VENDOR_MICROCHIP is not set
# CONFIG_NET_VENDOR_MICROSEMI is not set
# CONFIG_NET_VENDOR_NATSEMI is not set
# CONFIG_NET_VENDOR_NETRONOME is not set
# CONFIG_NET_VENDOR_NI is not set
# CONFIG_NET_VENDOR_PENSANDO is not set
# CONFIG_NET_VENDOR_QUALCOMM is not set
# CONFIG_NET_VENDOR_RENESAS is not set
# CONFIG_NET_VENDOR_ROCKER is not set
# CONFIG_NET_VENDOR_SAMSUNG is not set
# CONFIG_NET_VENDOR_SEEQ is not set
# CONFIG_NET_VENDOR_SOLARFLARE is not set
# CONFIG_NET_VENDOR_SMSC is not set
# CONFIG_NET_VENDOR_SOCIONEXT is not set
CONFIG_NET_VENDOR_STMICRO=y
# CONFIG_NET_VENDOR_SYNOPSYS is not set
# CONFIG_NET_VENDOR_VIA is not set
# CONFIG_NET_VENDOR_WIZNET is not set
# CONFIG_NET_VENDOR_XILINX is not set
# CONFIG_STANDALONE is not set
CONFIG_INPUT_FF_MEMLESS=y
CONFIG_INPUT_POLLDEV=y
CONFIG_INPUT_EVDEV=y
# CONFIG_LEGACY_PTYS is not set
CONFIG_RTC_CLASS=y
CONFIG_SYNC_FILE=y
CONFIG_SW_SYNC=y
CONFIG_PROC_KCORE=y
CONFIG_TMPFS=y
#CONFIG_FUSE_FS=y
CONFIG_CONFIGFS_FS=y
CONFIG_MSDOS_FS=y
CONFIG_VFAT_FS=y
CONFIG_FAT_DEFAULT_IOCHARSET="utf8"
CONFIG_FAT_DEFAULT_UTF8=y
CONFIG_NLS=y
CONFIG_NLS_DEFAULT="utf8"
CONFIG_NLS_CODEPAGE_437=y
CONFIG_NLS_ASCII=y
CONFIG_NLS_ISO8859_1=y
CONFIG_NLS_UTF8=y
CONFIG_PRINTK_TIME=y
CONFIG_BOOT_PRINTK_DELAY=y
CONFIG_DYNAMIC_DEBUG=y
CONFIG_DEBUG_FS=y
CONFIG_DEBUG_INFO=y
CONFIG_DEBUG_INFO_DWARF4=y
CONFIG_GDB_SCRIPTS=y
# CONFIG_ENABLE_WARN_DEPRECATED is not set
# CONFIG_ENABLE_MUST_CHECK is not set
CONFIG_FRAME_WARN=1024
CONFIG_UNUSED_SYMBOLS=y
CONFIG_MAGIC_SYSRQ=y
CONFIG_MAIGC_SYSRQ_DEFAULT_ENABLE=0x01b6
CONFIG_LOCKUP_DETECTOR=y
CONFIG_RCU_CPU_STALL_TIMEOUT=60
CONFIG_ARM64_PTDUMP=y
#CONFIG_MALI_MIDGARD=y
CONFIG_MALI_PLATFORM_NAME="candy"
CONFIG_COMPAT=y
CONFIG_KUSER_HELPERS=y
CONFIG_ARMV8_DEPRECATED=y
CONFIG_SWP_EMULATION=y
CONFIG_CP15_BARRIER_EMULATION=y
CONFIG_SETEND_EMULATION=y
CONFIG_BINFMT_ELF=y
CONFIG_COMPAT_BINFMT_ELF=y
CONFIG_RPMSG_CHAR=y
CONFIG_RPMSG_TTY=y
CONFIG_BINFMT_SCRIPT=y
CONFIG_TEE=y
CONFIG_OPTEE=y
#
# SOC
#
CONFIG_SOC_SP7350=y
CONFIG_PM=y
CONFIG_CPU_IDLE=y
CONFIG_ARM_PSCI_CPUIDLE=y
CONFIG_CPU_FREQ=y
CONFIG_ARM_SP7350_CPUFREQ=y
CONFIG_NVMEM_SUNPLUS_OCOTP=y
CONFIG_PINCTRL=y
CONFIG_PINCTRL_SPPCTL_SP7350=y
CONFIG_REMOTEPROC=y
CONFIG_SUNPLUS_REMOTEPROC=y
#
# USB
#
CONFIG_USB=y
CONFIG_USB_GADGET=y
CONFIG_USB_STORAGE=y
CONFIG_USB_XHCI_HCD=y
CONFIG_USB_DWC3=y
CONFIG_SUNPLUS_SYNOPSYS_USB3_PHY=y
CONFIG_EXTCON=y
CONFIG_EXTCON_USB_GPIO_SUNPLUS=y
CONFIG_USB_EHCI_HCD=y
CONFIG_USB_EHCI_SUNPLUS=y
#
# Regulators
#
CONFIG_REGULATOR_RT5759=y
CONFIG_REGULATOR_FIXED_VOLTAGE=y
#
# DMA Devices
#
CONFIG_DMADEVICES=y
CONFIG_DMA_ENGINE=y
CONFIG_DMA_OF=y
CONFIG_DW_DMAC_CORE=y
CONFIG_DW_DMAC=y
# SPI Master Controller Drivers
# CONFIG_SPI_DEBUG is not set
CONFIG_SPI=y
CONFIG_SPI_SPIDEV=y
CONFIG_SPI_SLAVE=y
CONFIG_SPI_MASTER=y
CONFIG_SPI_MEM=y
CONFIG_SPI_DESIGNWARE=y
CONFIG_SPI_DW_DMA=y
CONFIG_SPI_DW_MMIO=y
#
# I2C support
#
CONFIG_I2C=y
CONFIG_I2C_CHARDEV=y
CONFIG_I2C_DESIGNWARE_CORE=y
CONFIG_I2C_DESIGNWARE_SLAVE=y
CONFIG_I2C_DESIGNWARE_PLATFORM=y
#
# IIO ADC support
#
CONFIG_REGMAP_IRQ=y
CONFIG_IIO=y
CONFIG_IIO_BUFFER=y
CONFIG_IIO_CONFIGFS=y
CONFIG_IIO_TRIGGER=y
CONFIG_IIO_CONSUMERS_PER_TRIGGER=2
CONFIG_IIO_SW_DEVICE=y
CONFIG_IIO_SW_TRIGGER=y
CONFIG_IIO_TRIGGERED_EVENT=y
CONFIG_SUNPLUS_ADC=y
#
# THERMAL support
#
CONFIG_THERMAL=y
CONFIG_THERMAL_EMERGENCY_POWEROFF_DELAY_MS=0
CONFIG_THERMAL_HWMON=y
CONFIG_THERMAL_OF=y
CONFIG_THERMAL_DEFAULT_GOV_STEP_WISE=y
CONFIG_THERMAL_GOV_STEP_WISE=y
CONFIG_THERMAL_EMULATION=y
CONFIG_SUNPLUS_THERMAL=y
#
# STM GMAC and Reltek PHY support
#
CONFIG_PAGE_POOL=y
CONFIG_REGMAP_MMIO=y
CONFIG_MII=y
CONFIG_STMMAC_ETH=y
# CONFIG_STMMAC_SELFTESTS is not set
CONFIG_STMMAC_PLATFORM=y
# CONFIG_DWMAC_DWC_QOS_ETH is not set
CONFIG_DWMAC_GENERIC=y
# CONFIG_DWMAC_INTEL_PLAT is not set
CONFIG_PHYLINK=y
CONFIG_PHYLIB=y
CONFIG_SWPHY=y
CONFIG_FIXED_PHY=y
# CONFIG_SFP is not set
CONFIG_REALTEK_PHY=y
CONFIG_MDIO_DEVICE=y
CONFIG_MDIO_BUS=y
CONFIG_OF_MDIO=y
CONFIG_MDIO_DEVRES=y
```

## drivers/dma/sp-cbdma/Kconfig
```kconfig
#
# CBDMA subsystem configuration
#

menu "Sunplus CBDMA"

config SUNPLUS_CBDMA
	tristate "CBDMA Driver support"
	help
		Enable to support Sunplus CBDMA drivers
endmenu
```

## drivers/dma/sunplus/Kconfig
```kconfig
#
# CBDMA subsystem configuration
#

menu "Sunplus CB-DMA"

config SUNPLUS_CBDMA
	tristate "Sunplus SP7021 CB-DMA driver support"
	depends on SOC_SP7021
	help
	  Enable support for the Sunplus CB-DMA (CBUS DMA) controller.
	  This DMA engine is found on Sunplus SP7021 SoC. This DMA
	  engine is very flexible. It has an SRAM buffer which can be
	  used as a CBUS master storage device.

config SUNPLUS_CBDMA_Q645
	tristate "Sunplus Q645 CB-DMA driver support"
	depends on SOC_Q645
	help
	  Enable support for the Sunplus CB-DMA (CBUS DMA) controller.
	  This DMA engine is found on Sunplus Q645 SoC. This DMA engine
	  is very flexible. It has an SRAM buffer which can be used as a
	  CBUS master storage device.

endmenu
```

## drivers/gpio/gpio_sp/Kconfig
```kconfig
config GPIO_SC7021
	bool "SunPlus SC7021 GPIO"
	depends on ARCH_PENTAGRAM && OF_GPIO
	select GENERIC_IRQ_CHIP
	help
	  Say yes here to support the SC7021 SunPlus GPIO device.
```

## drivers/gpu/gpu_2d/Kconfig
```kconfig
# SPDX-License-Identifier: GPL-2.0-only
config GPU_2D
        bool "Support gpu_2d(GC520) driver"
        default y
        help
          Say yes if kernel should use gpu_2d.

          If unsure, choose Y.
```

## drivers/media/i2c/eSP876/Kconfig
```kconfig
config VIDEO_ESP876
	tristate "eYs3D eSP876 camera support"
	depends on VIDEO_V4L2 && I2C
	select MEDIA_CONTROLLER
	select VIDEO_V4L2_SUBDEV_API
	help
	  Support for the eYs3D eSP876 camera.

	  To compile this driver as a module, choose M here: the
	  module will be called esp876
```

## drivers/media/i2c/eYs3D/Kconfig
```kconfig
config VIDEO_EYS3D
	tristate "eYs3D Camera Sensor Driver Support"
	depends on VIDEO_V4L2 && I2C
	select MEDIA_CONTROLLER
	select VIDEO_V4L2_SUBDEV_API
	help
	  Support for the eYs3D Camera Sensor Driver.

	  To compile this driver as a module, choose M here: the
	  module will be called eys3d
```

## drivers/media/platform/sp-display/Kconfig
```kconfig
config VIDEO_SP_DISP
	tristate "SUNPLUS DISPLAY Driver"
	default n
	---help---
		Support for the SUNPLUS SP7021 display test.
```

## drivers/media/platform/sp-display/display/Kconfig
```kconfig
config VIDEO_SP_DISP
	tristate "SUNPLUS DISPLAY Driver"
	select VIDEOBUF2_DMA_CONTIG
	select VIDEOBUF2_VMALLOC	
	default y
	---help---
		Support for the SUNPLUS SP7021 display test.
```

## drivers/media/platform/sp-display/hdmitx/Kconfig
```kconfig
config VIDEO_SP_HDMITX
	tristate "SUNPLUS HDMITX Driver"
	select PINCTRL
	select PINCTRL_SPPCTL
	default y
	---help---
		Support for the SUNPLUS SP7021 display.
```

## drivers/media/platform/sunplus/display/sp7350/Kconfig
```kconfig
# SPDX-License-Identifier: GPL-2.0

config VIDEO_SP7350_DISP
	tristate "SUNPLUS SP7350 DISPLAY Driver"
	depends on VIDEO_DEV && VIDEO_V4L2 && SOC_SP7350
	select VIDEOBUF2_DMA_CONTIG
	select VIDEOBUF2_VMALLOC
	# select FB_SP7350
	default y
	help
		Support for the SUNPLUS SP7350 display driver.

config VIDEO_SP7350_DISP_DEBUG
	bool "External Debug support"
	depends on VIDEO_SP7350_DISP
	help
	  Say Y here, if you want to have debug support.
	  Debug function reserved for display further check.
	  echo "dump all" > /sys/module/display_sp7350/parameter/debug
	  can show more info for display driver details.
```

## drivers/media/platform/sunplus/ethos-n78/Kconfig
```kconfig
config ETHOS_N78_NPU
	tristate "ML Inference Processor ETHOS-N78-NPU driver"
	default n
	---help---
		Support for the ML Inference Processor ETHOS-N78-NPU driver.
```
