## drivers/media/platform/sunplus/mipicsi/Kconfig
```kconfig
# SPDX-License-Identifier: GPL-2.0
#
# Sunplus MIPI/CSI RX driver configuration
#

config MIPICSI_RX_SUNPLUS_SP7021
	tristate "Sunplus SP7021 MIPI/CSI-RX driver"
	depends on SOC_SP7021 && VIDEO_DEV && VIDEO_V4L2
	select VIDEOBUF2_DMA_CONTIG
	select VIDEOBUF2_VMALLOC
	default n
	help
	  This driver supports the MIPI/CSI-RX device on the
	  Sunplus SP7021 SoC. If you have the device, say Y.
	  To compile this driver as a module, choose M here.
	  The module will be called sp-mipi-sp7021.

config MIPICSI_RX_SUNPLUS_SP7021_NEW
	tristate "Sunplus SP7021 new MIPI/CSI-RX driver"
	depends on SOC_SP7021 && VIDEO_DEV && VIDEO_V4L2
	select VIDEOBUF2_DMA_CONTIG
	select VIDEOBUF2_VMALLOC
	select V4L2_FWNODE
	default n
	help
	  This driver supports the MIPI/CSI-RX device on the
	  Sunplus SP7021 SoC. If you have the device, say Y.
	  To compile this driver as a module, choose M here.
	  The module will be called sp-mipi-sp7021.

config MIPICSI_RX_SUNPLUS_Q645
	tristate "Sunplus Q645 MIPI/CSI-RX driver"
	depends on SOC_Q645 && VIDEO_DEV && VIDEO_V4L2
	select VIDEOBUF2_DMA_CONTIG
	select VIDEOBUF2_VMALLOC
	default n
	help
	  This driver supports the MIPI/CSI-RX device on the
	  Sunplus Q645 SoC. If you have the device, say Y.
	  To compile this driver as a module, choose M here.
	  The module will be called sp-mipi-q645.

config MIPICSI_RX_SUNPLUS_Q645_NEW
	tristate "Sunplus Q645 new MIPI/CSI-RX driver"
	depends on SOC_Q645 && VIDEO_DEV && VIDEO_V4L2
	select VIDEOBUF2_DMA_CONTIG
	select VIDEOBUF2_VMALLOC
	select V4L2_FWNODE
	default n
	help
	  This driver supports the MIPI/CSI-RX device on the
	  Sunplus Q645 SoC. If you have the device, say Y.
	  To compile this driver as a module, choose M here.
	  The module will be called sp-mipi-q645.

config VIDEO_SUNPLUS_Q654_CSI2
	tristate "Sunplus Q654 MIPI CSI-2 Receiver"
	depends on VIDEO_V4L2 && OF
	depends on SOC_Q654
	select MEDIA_CONTROLLER
	select VIDEO_V4L2_SUBDEV_API
	select RESET_CONTROLLER
	select V4L2_FWNODE
	help
	  Support for Sunplus MIPI CSI-2 receiver.
	  Supports Q654 SoC.

	  To compile this driver as a module, choose M here: the
	  module will be called sp-mipi-q654.

config VIDEO_SUNPLUS_Q654_VIN
	tristate "Sunplus Q654 Video Input (VIN) Driver"
	depends on VIDEO_V4L2 && OF
	depends on SOC_Q654
	select MEDIA_CONTROLLER
	select VIDEO_V4L2_SUBDEV_API
	select VIDEOBUF2_DMA_CONTIG
	select V4L2_FWNODE
	help
	  Support for Sunplus Video Input (VIN) driver.
	  Supports Q654 SoC.

	  To compile this driver as a module, choose M here: the
	  module will be called sp-vin-q654.
```

## drivers/media/platform/sunplus/video/Kconfig
```kconfig
# SPDX-License-Identifier: GPL-2.0
#
# Sunplus video sensor configuration
#

menuconfig SUNPLUS_VIDEO_SENSOR_SUPPORT
	bool "Sunplus Video Sensor Support"
	help
	  Enable video sensor support.
	  If you have video sensor devices, say Y.
	  Note that this option doesn't include new drivers
	  in the kernel. Saying N causes skipping all the
	  questions in submenu.

if SUNPLUS_VIDEO_SENSOR_SUPPORT

config VIDEO_SENSOR_GC0310
	tristate "Video Sensor (GC0310) Driver"
	depends on SOC_SP7021 && MIPICSI_RX_SUNPLUS_SP7021
	default n
	help
	  Supports video sensor GC0310.
	  If you have GC0310 video sensor device, say Y.
	  To compile this driver as a module, choose M here.
	  The module will be called gc0310.

config VIDEO_SENSOR_IMX219
	tristate "Video Sensor (IMX219) Driver"
	depends on SOC_SP7021 && MIPICSI_RX_SUNPLUS_SP7021
	default n
	help
	  Supports video sensor IMX219.
	  If you have IMX219 video sensor device, say Y.
	  To compile this driver as a module, choose M here.
	  The module will be called imx219.

config VIDEO_SENSOR_VEYE290
	tristate "Video Sensor (VEYE290) Driver"
	depends on SOC_SP7021 && MIPICSI_RX_SUNPLUS_SP7021
	default n
	help
	  Supports video sensor VEYE290.
	  If you have VEYE290 video sensor device, say Y.
	  To compile this driver as a module, choose M here.
	  The module will be called veye290.

config VIDEO_SENSOR_OV5647
	tristate "Video Sensor (OV5647) Driver"
	depends on SOC_SP7021 && MIPICSI_RX_SUNPLUS_SP7021
	default n
	help
	  Supports video sensor OV5647.
	  If you have OV5647 video sensor device, say Y.
	  To compile this driver as a module, choose M here.
	  The module will be called ov5647.

config VIDEO_SENSOR_OV9281
	depends on SOC_SP7021 && MIPICSI_RX_SUNPLUS_SP7021
	tristate "Video Sensor (OV9281) Driver"
	default n
	help
	  Supports video sensor OV9281.
	  If you have OV9281 video sensor device, say Y.
	  To compile this driver as a module, choose M here.
	  The module will be called ov9281.

config VIDEO_SENSOR_OV9281_ISP
	tristate "Video Sensor (OV9281_ISP) Driver"
	depends on SOC_SP7021 && MIPICSI_RX_SUNPLUS_SP7021
	default n
	help
	  Supports SunplusIT 3D Eye-tracker (video sensor OV9281 + ISP)
	  board. If you have this device, say Y.
	  This driver does not support auto sensor detection.
	  It will be loaded in unconditionally when it is enabled.
	  Please disable other video sensor drivers.
	  To compile this driver as a module, choose M here.
	  The module will be called ov9281_isp.

endif
```

## drivers/media/platform/sunplus/videocodec/Kconfig
```kconfig
config VIDEO_HANTRO_DECODER
	tristate "HANTRO VC8000D video decoder driver"
	default n
	---help---
		Support for the hardware decoder driver.

config VIDEO_HANTRO_ENCODER
	tristate "HANTRO VC8000D video encoder driver"
	default n
	---help---
		Support for the hardware encoder driver.

config VIDEO_HANTRO_DECODER_MEM
	tristate "HANTRO VC8000E video decoder memory driver"
	default n
	---help---
		Support for the hardware decoder memory driver.

config VIDEO_HANTRO_ENCODER_MEM
	tristate "HANTRO VC8000E video encoder memory driver"
	default n
	---help---
		Support for the hardware encoder memory driver.
```

## drivers/media/sp-mipi/Kconfig
```kconfig
config VIDEO_SP_MIPICSI_RX
	tristate "Sunplus MIPI/CSI-RX Driver"
	select VIDEO_V4L2
	select VIDEOBUF_GEN
	select VIDEOBUF_DMA_CONTIG
	default n
	---help---
	  Sunplus MIPI/CSI-RX driver supports for Sunplus SP-7021 based boards.
```

## drivers/media/video/Kconfig
```kconfig
menuconfig SUNPLUS_VIDEO_SENSOR_SUPPORT
	bool "Sunplus Video Sensor Support"
	help
	  Enable video sensor support.
	  If you have such devices, say Y.

if SUNPLUS_VIDEO_SENSOR_SUPPORT

config VIDEO_SENSOR_OV9281
	tristate "Video Sensor (OV9281) Driver"
	default n
	---help---
	  Video sensor for OV9281

config VIDEO_SENSOR_GC0310
	tristate "Video Sensor (GC0310) Driver"
	default n
	---help---
	  Video sensor for GC0310

endif
```

## drivers/net/ethernet/sp/Kconfig
```kconfig
#
# Sunplus Ethernet device configuration
#

config NET_VENDOR_SUNPLUS
	tristate "Sunplus devices"
	depends on ETHERNET
	---help---
	  If you have a network (Ethernet) device belonging to this class, say Y.

	  Note that the answer to this question doesn't directly affect
	  the kernel: saying N will just case the configurator to skip all
	  the questions about Sunplus device. If you say Y, you will be asked
	  for your specific device in the following questions.

choice
	prompt "Selected Mode"
	depends on NET_VENDOR_SUNPLUS
	default AN_NIC_WITH_DAISY_CHAIN_MODE

config AN_NIC_WITH_DAISY_CHAIN
	bool "An NIC with Daisy-chain Mode"
	select PHYLIB
	select GPIO_SC7021
	select SUNPLUS_SP7021_RESET
	select NVMEM_SUNPLUS_OCOTP
	---help---
	  This mode supports an NIC with daisy-chain support on the other port.

config DUAL_NIC
	bool "Dual NIC Mode"
	select PHYLIB
	select GPIO_SC7021
	select SUNPLUS_SP7021_RESET
	select NVMEM_SUNPLUS_OCOTP
	---help---
	  This mode supports dual NIC.

endchoice
```
