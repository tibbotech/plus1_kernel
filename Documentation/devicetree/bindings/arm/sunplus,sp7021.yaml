## Documentation/devicetree/bindings/gpio/sc7021,sp_gpio.txt
```
---------------------------------------------
  SoC SunPlus/Tibbo SC7021 gpio driver (sc7021_gpio)
---------------------------------------------

This document outlines the gpio subsystem available on SC7021 SoC.

Available functions:

- old and new /sys gpio interface API
- 72 gpio lines (8 groups of 8 pins), 8 interrupt lines on GPIO1 group
- human-readable representation of the current gpio configuration in
  /sys/kernel/debug/gpio

------
Files
------

The driver directories and files are:

- (dir)  /sys/devices/platform/soc@B/9c000300.gpio
- (dir)  /sys/class/gpio
- (file) /sys/kernel/debug/gpio
- (dir)  /sys/firmware/devicetree/base/soc@B/gpio@0x9C000300

---------
DTS file
---------

A driver is platform dependent, requested by DTS node.

Example:

    soc@B {
	gpio: gpio@0x9C000300 {
    	    compatible = "sc7021,sp_gpio";
    	    reg = <0x9C000300 0x80>, <0x9C000380 0x80>, <0x9C0032e4 0x80>;
    	    interrupt-parent = <&intc>;
    	    interrupts =
    	    <120 IRQ_TYPE_LEVEL_HIGH>,
    	    <121 IRQ_TYPE_LEVEL_HIGH>,
    	    <122 IRQ_TYPE_LEVEL_HIGH>,
    	    <123 IRQ_TYPE_LEVEL_HIGH>,
    	    <124 IRQ_TYPE_LEVEL_HIGH>,
    	    <125 IRQ_TYPE_LEVEL_HIGH>,
    	    <126 IRQ_TYPE_LEVEL_HIGH>,
    	    <127 IRQ_TYPE_LEVEL_HIGH>;
    	    resets = <&rstc RST_GPIO>;
	};
    }

All properties are optional and has compile-time default values.

The compatible key may have one of the following values:

- sunplus,sp_gpio
- pentagram,sp_gpio
- tps,spgpio
- tibbo,spgpio
- sc7021,sp_gpio

The reg key should contain 3 entries - the physical addresses of GPIO control 
register groups.
```

## Documentation/devicetree/bindings/i2c/i2c-sunplus.txt
```
* Sunplus's I2C controller

The Sunplus's I2C controller is used to interface with I2C devices.

Required properties:
- compatible:
 Should be "sunplus,sp7021-i2cm":  for i2c sp7021
 Should be "sunplus,q645-i2cm":    for i2c sp7021

Optional properties:
  - clock-frequency: Frequency in Hz of the bus when transfer, the default value
    is 100000.


Example:

		i2cm0: i2c@sp_i2cm0 {
			compatible = "sunplus,sp7021-i2cm";
			reg = <0x9c004600 0x80>, <0x9c004680 0x80>;
			reg-names = "i2cm", "i2cmdma";
			interrupt-parent = <&intc>;
			interrupts = <174 IRQ_TYPE_LEVEL_HIGH>;
			clocks = <&clkc I2CM0>;
			resets = <&rstc RST_I2CM0>;
		};

	&i2cm0 {
		clock-frequency = <100000>;
	};
```

## Documentation/devicetree/bindings/i2c/i2c-sunplus.yaml
```yaml
# SPDX-License-Identifier: (GPL-2.0 OR BSD-2-Clause)
%YAML 1.2
---
$id: http://devicetree.org/schemas/i2c/i2c-sunplus.yaml#
$schema: http://devicetree.org/meta-schemas/core.yaml#

title: Sunplus's I2C controller

allOf:
  - $ref: /schemas/i2c/i2c-controller.yaml#

maintainers:
  - lh.kuo <lh.kuo@sunplus.com>

properties:
  compatible:
    enum:
      - sunplus,sp7021-i2cm
      - sunplus,q645-i2cm

  reg:
    items:
      - description: Base address and length of the I2C registers
      - description: Base address and length of the I2C DMA registers

  reg-names:
    items:
      - const: i2cm
      - const: i2cmdma

  interrupts:
    maxItems: 1

  clocks:
    maxItems: 1

  resets:
    maxItems: 1

  clock-frequency:
    enum: [ 100000, 400000 ]

required:
  - compatible
  - reg
  - reg-names
  - interrupts
  - clocks
  - resets

additionalProperties: false

examples:
  - |
    #include <dt-bindings/clock/sp-sp7021.h>
    #include <dt-bindings/reset/sp-sp7021.h>
    #include <dt-bindings/interrupt-controller/irq.h>
    i2cm0: i2c@9C004600 {
        compatible = "sunplus,sp7021-i2cm";
        reg = <0x9c004600 0x80>, <0x9c004680 0x80>;
        reg-names = "i2cm", "i2cmdma";
        interrupt-parent = <&intc>;
        interrupts = <174 IRQ_TYPE_LEVEL_HIGH>;
        clocks = <&clkc I2CM0>;
        resets = <&rstc RST_I2CM0>;
        clock-frequency = <100000>;
    };
...
```

## Documentation/devicetree/bindings/interrupt-controller/sunplus,sp7021-intc.txt
```
Sunplus SP7021 SoC interrupt controller

Required properties:
 - compatible: should be "sunplus,sp7021-intc"
 - interrupt-controller: identifies the node as an interrupt controller
 - #interrupt-cells: specifies the number of cells needed to encode an interrupt
                     source, should be 2.
 - reg: addresses and length of the register sets for interrupt controller.
 - interrupt-parent: phandle to the parent interrupt controller.
 - interrupts: specifies the interrupt lines to the interrupt-parent controller
               The first item is interrupt type, the second is interrupt number,
               and the latest is trigger type.
 - ext0-mask: cpu affiniity of EXT_INT0
 - ext1-mask: cpu affiniity of EXT_INT1
   - mask:
     Setting bit 0 to 1 means the interrupt will be sent to core 0.
     Setting bit 1 to 1 means the interrupt will be sent to core 1.
     Setting bit 2 to 1 means the interrupt will be sent to core 2.
     Setting bit 3 to 1 means the interrupt will be sent to core 3.

Example:
intc: interrupt-controller@0x9c000780 {
	compatible = "sunplus,sp7021-intc";
	interrupt-controller;
	#interrupt-cells = <2>;
	reg = <0x9c000780 0x80>, <0x9c000a80 0x80>;
	interrupt-parent = <&gic>;
	interrupts = <GIC_SPI 5 IRQ_TYPE_LEVEL_HIGH>, /* EXT_INT0 */
		     <GIC_SPI 6 IRQ_TYPE_LEVEL_HIGH>; /* EXT_INT1 */
	ext0-mask = <0xf>; /* core0-3 */
	ext1-mask = <0xe>; /* core1-3 */
};
```

## Documentation/devicetree/bindings/interrupt-controller/sunplus,sp7021-intc.yaml
```yaml
# SPDX-License-Identifier: (GPL-2.0-only OR BSD-2-Clause)
# Copyright (C) Sunplus Co., Ltd. 2021
%YAML 1.2
---
$id: http://devicetree.org/schemas/interrupt-controller/sunplus,sp7021-intc.yaml#
$schema: http://devicetree.org/meta-schemas/core.yaml#

title: Sunplus SP7021 SoC Interrupt Controller Device Tree Bindings

maintainers:
  - Qin Jian <qinjian@cqplus1.com>

properties:
  compatible:
    items:
      - const: sunplus,sp7021-intc

  interrupt-controller: true

  "#interrupt-cells":
    const: 2
    description:
      The first cell is the IRQ number, the second cell the trigger
      type as defined in interrupt.txt in this directory.

  reg:
    maxItems: 2

  interrupts:
    maxItems: 2
    description:
      EXT_INT0 & EXT_INT1, 2 interrupts references to primary interrupt
      controller.

  sunplus,ext0-mask:
    description:
      cpu affinity of EXT_INT0.
    $ref: "/schemas/types.yaml#/definitions/uint32"
    minimum: 1
    maximum: 15

  sunplus,ext1-mask:
    description:
      cpu affinity of EXT_INT1.
    $ref: "/schemas/types.yaml#/definitions/uint32"
    minimum: 1
    maximum: 15

required:
  - compatible
  - interrupt-controller
  - "#interrupt-cells"
  - reg
  - interrupts

additionalProperties: false

examples:
  - |
    #include <dt-bindings/interrupt-controller/arm-gic.h>

    intc: interrupt-controller@9c000780 {
        compatible = "sunplus,sp7021-intc";
        interrupt-controller;
        #interrupt-cells = <2>;
        reg = <0x9c000780 0x80>, <0x9c000a80 0x80>;
        interrupt-parent = <&gic>;
        interrupts = <GIC_SPI 5 IRQ_TYPE_LEVEL_HIGH>, /* EXT_INT0 */
                    <GIC_SPI 6 IRQ_TYPE_LEVEL_HIGH>; /* EXT_INT1 */
        sunplus,ext0-mask = <0xf>; /* core0-3 */
        sunplus,ext1-mask = <0xe>; /* core1-3 */
    };

...
```

## Documentation/devicetree/bindings/mailbox/sunplus-mailbox.txt
```
* Sunplus SP7021 MAILBOX *

This file documents the properties used by the mailbox driver.

Required properties:
- compatible:
 Should be "sunplus,sp7021-ipc": for sp7021

Optional properties:

Example:
		ipc: ipc@G258 {
			compatible = "sunplus,sp7021-ipc";
			reg = <0x9c008100 0x100>; /* G258 ~ G259 */
			interrupt-parent = <&intc>;
			interrupts =
				<182 IRQ_TYPE_EDGE_RISING>, /* ACHIPCPU0_DIRECT_INT0 */
				<183 IRQ_TYPE_EDGE_RISING>, /* ACHIPCPU0_DIRECT_INT1 */
				<184 IRQ_TYPE_EDGE_RISING>, /* ACHIPCPU0_DIRECT_INT2 */
				<185 IRQ_TYPE_EDGE_RISING>, /* ACHIPCPU0_DIRECT_INT3 */
				<186 IRQ_TYPE_EDGE_RISING>, /* ACHIPCPU0_DIRECT_INT4 */
				<187 IRQ_TYPE_EDGE_RISING>, /* ACHIPCPU0_DIRECT_INT5 */
				<188 IRQ_TYPE_EDGE_RISING>, /* ACHIPCPU0_DIRECT_INT6 */
				<189 IRQ_TYPE_EDGE_RISING>, /* ACHIPCPU0_DIRECT_INT7 */
				<190 IRQ_TYPE_EDGE_RISING>, /* A926_DIRECT_INT0 */
				<191 IRQ_TYPE_EDGE_RISING>, /* A926_DIRECT_INT1 */
				<192 IRQ_TYPE_EDGE_RISING>, /* A926_DIRECT_INT2 */
				<193 IRQ_TYPE_EDGE_RISING>, /* A926_DIRECT_INT3 */
				<194 IRQ_TYPE_EDGE_RISING>, /* A926_DIRECT_INT4 */
				<195 IRQ_TYPE_EDGE_RISING>, /* A926_DIRECT_INT5 */
				<196 IRQ_TYPE_EDGE_RISING>, /* A926_DIRECT_INT6 */
				<197 IRQ_TYPE_EDGE_RISING>, /* A926_DIRECT_INT7 */
				<198 IRQ_TYPE_EDGE_RISING>, /* ACHIPCPU0_INT */
				<199 IRQ_TYPE_EDGE_RISING>; /* A926_INT */
		};
```

## Documentation/devicetree/bindings/mailbox/sunplus-mailbox.yaml
```yaml
# SPDX-License-Identifier: (GPL-2.0-only OR BSD-2-Clause)
# Copyright (C) Sunplus Ltd. Co. 2021
%YAML 1.2
---
$id: http://devicetree.org/schemas/mailbox/sunplus-mailbox.yaml#
$schema: http://devicetree.org/meta-schemas/core.yaml#

title: Sunplus Mailbox controller

maintainers:
  - tony.huang <tony.huang@sunplus.com>

description: |
  The driver is to communicate with the Mailbox related hardware
  and get the information.

properties:
  compatible:
    enum:
      - sunplus,sp7021-ipc

  reg:
    description:
      Group 258 Transfer data from ACHIP-CPU0 to ARM926
      Group 259 Transfer data from ARM926 to ACHIP-CPU0

  interrupts:
    maxItems: 18

required:
  - compatible
  - reg
  - interrupts

additionalProperties: false

examples:
  - |
    #include <dt-bindings/interrupt-controller/irq.h>
    #include <dt-bindings/interrupt-controller/arm-gic.h>
    ipc: ipc@9c008100 {
        compatible = "sunplus,sp7021-ipc";
        reg = <0x9c008100 0x100>; /* G258 ~ G259 */
        interrupt-parent = <&intc>;
        interrupts =
            <182 IRQ_TYPE_EDGE_RISING>, /* ACHIPCPU0_DIRECT_INT0 */
            <183 IRQ_TYPE_EDGE_RISING>, /* ACHIPCPU0_DIRECT_INT1 */
            <184 IRQ_TYPE_EDGE_RISING>, /* ACHIPCPU0_DIRECT_INT2 */
            <185 IRQ_TYPE_EDGE_RISING>, /* ACHIPCPU0_DIRECT_INT3 */
            <186 IRQ_TYPE_EDGE_RISING>, /* ACHIPCPU0_DIRECT_INT4 */
            <187 IRQ_TYPE_EDGE_RISING>, /* ACHIPCPU0_DIRECT_INT5 */
            <188 IRQ_TYPE_EDGE_RISING>, /* ACHIPCPU0_DIRECT_INT6 */
            <189 IRQ_TYPE_EDGE_RISING>, /* ACHIPCPU0_DIRECT_INT7 */
            <190 IRQ_TYPE_EDGE_RISING>, /* A926_DIRECT_INT0 */
            <191 IRQ_TYPE_EDGE_RISING>, /* A926_DIRECT_INT1 */
            <192 IRQ_TYPE_EDGE_RISING>, /* A926_DIRECT_INT2 */
            <193 IRQ_TYPE_EDGE_RISING>, /* A926_DIRECT_INT3 */
            <194 IRQ_TYPE_EDGE_RISING>, /* A926_DIRECT_INT4 */
            <195 IRQ_TYPE_EDGE_RISING>, /* A926_DIRECT_INT5 */
            <196 IRQ_TYPE_EDGE_RISING>, /* A926_DIRECT_INT6 */
            <197 IRQ_TYPE_EDGE_RISING>, /* A926_DIRECT_INT7 */
            <198 IRQ_TYPE_EDGE_RISING>, /* ACHIPCPU0_INT */
            <199 IRQ_TYPE_EDGE_RISING>; /* A926_INT */
    };
...
```

## Documentation/devicetree/bindings/media/sunplus,q645-mipicsi-rx.txt
```
Sunplus Q645 MIPI/CSI RX controller
-------------------------------------

The device node of Sunplus Q645 MIPI/CSI RX controller has following
properties.

Required properties:
 - compatible: should be "sunplus,q645-mipicsi-rx".
 - reg: addresses and length of the register sets for MIPI CSI and CSIIW
        controller.
 - reg-names: one name for each entry in the reg property.
 - interrupt-parent: phandle for interrupt parent.
 - interrupts: number and type of interrupt, type should be high-level.
               the first is for MIPI CSI, the second is for CSIIW.
 - clocks: clock selector for MIPI CSI and CSIIW controller.
 - resets: reset controller selector for MIPI CSI and CSIIW controller.
 - pinctrl-names: Names corresponding to the numbered pinctrl states.
 - pinctrl-0: phandle for the 'default' state of pin configuration.
 - i2c-id: channel number of I2C.

Example:

mipicsi0: mipicsirx@0xf8005280 {
	compatible = "sunplus,q645-mipicsi-rx";
	reg = <0x0 0xf8005280 0x0 0x80>, <0x0 0xf8005300 0x0 0x80>;
	reg-names = "mipicsi", "csiiw";
	interrupt-parent = <&gic>;
	interrupts = <GIC_SPI 80 IRQ_TYPE_EDGE_RISING>,
		     <GIC_SPI 81 IRQ_TYPE_EDGE_RISING>;
	clocks = <&clkc MIPICSI0>, <&clkc CSIIW0>;
	clock-names = "clk_mipicsi", "clk_csiiw";
	resets = <&rstc RST_MIPICSI0>, <&rstc RST_CSIIW0>;
	reset-names = "rstc_mipicsi", "rstc_csiiw";
	i2c-id = <2>;
	status = "disabled";
};
```

## Documentation/devicetree/bindings/media/sunplus,sp7021-mipicsi-rx.txt
```
Sunplus SP7021 MIPI/CSI RX controller
-------------------------------------

The device node of Sunplus SP7021 MIPI/CSI RX controller has following
properties.

Required properties:
 - compatible: should be "sunplus,sp7021-mipicsi-rx".
 - reg: addresses and length of the register sets for MIPI CSI and CSIIW
        controller.
 - reg-names: one name for each entry in the reg property.
 - interrupt-parent: phandle for interrupt parent.
 - interrupts: number and type of interrupt, type should be high-level.
               the first is for MIPI CSI, the second is for CSIIW.
 - clocks: clock selector for MIPI CSI and CSIIW controller.
 - resets: reset controller selector for MIPI CSI and CSIIW controller.
 - pinctrl-names: Names corresponding to the numbered pinctrl states.
 - pinctrl-0: phandle for the 'default' state of pin configuration.
 - i2c-id: channel number of I2C.

Example:

mipicsi0: mipicsirx@0x9C005280 {
	compatible = "sunplus,sp7021-mipicsi-rx";
	reg = <0x9C005280 0x80>, <0x9C005300 0x80>;
	reg-names = "mipicsi", "csiiw";
	interrupt-parent = <&intc>;
	interrupts = <49 IRQ_TYPE_EDGE_RISING>,
		     <50 IRQ_TYPE_EDGE_RISING>;
	clocks = <&clkc MIPICSI0>, <&clkc CSIIW0>;
	clock-names = "clk_mipicsi", "clk_csiiw";
	resets = <&rstc RST_MIPICSI0>, <&rstc RST_CSIIW0>;
	reset-names = "rstc_mipicsi", "rstc_csiiw";
	pinctrl-names = "default";
	pinctrl-0 = <&mipicsi0_pins>;
	i2c-id = <1>;
};
```
