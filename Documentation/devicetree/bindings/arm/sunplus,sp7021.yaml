## Documentation/devicetree/bindings/arm/sunplus,sp7021.yaml
```yaml
# SPDX-License-Identifier: (GPL-2.0-only OR BSD-2-Clause)
# Copyright (C) Sunplus Co., Ltd. 2021
%YAML 1.2
---
$id: http://devicetree.org/schemas/arm/sunplus,sp7021.yaml#
$schema: http://devicetree.org/meta-schemas/core.yaml#

title: Sunplus SP7021 Boards Device Tree Bindings

maintainers:
  - qinjian <qinjian@cqplus1.com>

description: |
  Boards with Sunplus SP7021 SoC

properties:
  $nodename:
    const: '/'
  compatible:
    oneOf:
      - items:
          - const: sunplus,sp7021-achip

additionalProperties: true

...
```

## Documentation/devicetree/bindings/clock/sunplus,q645-clkc.txt
```
Sunplus Q645 SoC clock controller

Required properties:
- compatible: should be "sunplus,q645-clkc"
- #clock-cells: Specifies the number of cells needed to encode clock line,
                should be 1.
- reg: address and length of the register set for clock controller

Example:
clkc: clkc@0xf8000000 {
	compatible = "sunplus,q645-clkc";
	#clock-cells = <1>;
	reg = <0x00 0xf8000000 0x00 0x280>;
};
```

## Documentation/devicetree/bindings/clock/sunplus,q645-clkc.yaml
```yaml
# SPDX-License-Identifier: (GPL-2.0 OR BSD-2-Clause)
%YAML 1.2
---
$id: http://devicetree.org/schemas/clock/sunplus,q645-clkc.yaml#
$schema: http://devicetree.org/meta-schemas/core.yaml#

title: Sunplus Q645 SoC Clock Controller Binding

maintainers:
  - Qin Jian <qinjian@cqplus1.com>

properties:
  compatible:
    const: sunplus,q645-clkc

  "#clock-cells":
    const: 1

  reg:
    maxItems: 1

required:
  - compatible
  - "#clock-cells"
	- reg

additionalProperties: false

examples:
  - |
    clkc: clkc@0xf8000000 {
	    compatible = "sunplus,q645-clkc";
	    #clock-cells = <1>;
	    reg = <0x00 0xf8000000 0x00 0x280>;
    };

...
```

## Documentation/devicetree/bindings/clock/sunplus,sp7021-clkc.txt
```
Sunplus SP7021 SoC clock controller

Required properties:
- compatible: should be "sunplus,sp7021-clkc"
- #clock-cells: Specifies the number of cells needed to encode clock line,
                should be 1.

Example:
clkc: clkc@0 {
	compatible = "sunplus,sp7021-clkc";
	#clock-cells = <1>;
};
```

## Documentation/devicetree/bindings/clock/sunplus,sp7021-clkc.yaml
```yaml
# SPDX-License-Identifier: (GPL-2.0 OR BSD-2-Clause)
%YAML 1.2
---
$id: http://devicetree.org/schemas/clock/sunplus,sp7021-clkc.yaml#
$schema: http://devicetree.org/meta-schemas/core.yaml#

title: Sunplus SP7021 SoC Clock Controller Binding

maintainers:
  - Qin Jian <qinjian@cqplus1.com>

properties:
  compatible:
    const: sunplus,sp7021-clkc

  "#clock-cells":
    const: 1

required:
  - compatible
  - "#clock-cells"

additionalProperties: false

examples:
  - |
    clkc: clkc@0 {
      compatible = "sunplus,sp7021-clkc";
      #clock-cells = <1>;
    };

...
```

## Documentation/devicetree/bindings/crypto/sunplus,sp7021-crypto.txt
```
Sunplus SP7021 SoC Crypto Engines / Security Accelerator (SEC)

Required properties:
- compatible : Should contain entries for this and backward compatible
- reg : Offset and length of the register set for the device
- clocks : phandle to clock-controller plus clock-specifier pair
- resets : phandles to the reset lines needed for this power demain sequence
	as described in ../reset/reset.txt
- interrupt-parent : phandle to the parent interrupt controller.
- interrupts : the SEC's interrupt number

Example:

	crypto: crypto@G84 {
		compatible = "sunplus,sp7021-crypto";
		reg = <0x9c002a00 0x100>; /* G84 ~ G85 */
		clocks = <&clkc SEC>;
		resets = <&rstc RST_SEC>;
		interrupt-parent = <&intc>;
		interrupts = <148 IRQ_TYPE_LEVEL_HIGH>;
	};
```

## Documentation/devicetree/bindings/crypto/sunplus,sp7021-crypto.yaml
```yaml
# SPDX-License-Identifier: (GPL-2.0-only OR BSD-2-Clause)
# Copyright (C) Sunplus Co., Ltd. 2021
%YAML 1.2
---
$id: http://devicetree.org/schemas/crypto/sunplus,sp7021-crypto.yaml#
$schema: http://devicetree.org/meta-schemas/core.yaml#

title: Sunplus SP7021 SoC Crypto Engine (SEC) Bindings

maintainers:
  - Qin Jian <qinjian@cqplus1.com>

properties:
  compatible:
    const: sunplus,sp7021-crypto

  reg:
    maxItems: 1

  clocks:
    maxItems: 1

  resets:
    maxItems: 1

  interrupts:
    maxItems: 1

required:
  - compatible
  - reg
  - clocks
  - resets
  - interrupts

additionalProperties: false

examples:
  - |
    #include <dt-bindings/interrupt-controller/irq.h>
    #include <dt-bindings/clock/sp-sp7021.h>
    #include <dt-bindings/reset/sp-sp7021.h>

    crypto: crypto@9c002a00 {
      compatible = "sunplus,sp7021-crypto";
      reg = <0x9c002a00 0x100>; /* G84 ~ G85 */
      clocks = <&clkc SEC>;
      resets = <&rstc RST_SEC>;
      interrupt-parent = <&intc>;
      interrupts = <148 IRQ_TYPE_LEVEL_HIGH>;
    };

...
```

## Documentation/devicetree/bindings/display/sc7021-fb.txt
```
Sunplus SC7021 series SoC Graphics Backend framebuffer driver

Required properties:
- compatible: should be "sunplus,sp7021-fb"
- memory-region: phandle to a node describing memory.

Example:

fb_reserve: fb_device {
	compatible = "sunplus,sp7021-fb_device_mem";
	size = <0x802000>;	//1366*768*4 alignment 1024, and double buffer.
	alignment = <1024>;
	reusable;
};

fb_device {
	compatible = "sunplus,sp7021-fb";
	memory-region = <&fb_reserve>;
};
```

## Documentation/devicetree/bindings/display/sunplus/sunplus,display.txt
```
Device-Tree bindings for display driver

Required properties:
- compatible: Should be "sunplus,sp7021-display"

Example:

		sp_display: display@0x9c005c80 {
			compatible = "sunplus,sp7021-display";
			reg = <0x9c005c80 0x1980>, <0x9c105000 0x80>;
			interrupt-parent = <&intc>;
			interrupts = <0 (IRQ_TYPE_EDGE_RISING | SP_INTC_EXT_INT1)>,
				     <1 (IRQ_TYPE_EDGE_RISING | SP_INTC_EXT_INT1)>,
				     <4 (IRQ_TYPE_EDGE_RISING | SP_INTC_EXT_INT1)>,
				     <5 (IRQ_TYPE_EDGE_RISING | SP_INTC_EXT_INT1)>;
			clocks = <&clkc TGEN>,
				 <&clkc DMIX>,
				 <&clkc OSD0>,
				 <&clkc GPOST0>,
				 <&clkc VPOST>,
				 <&clkc DDFCH>,
				 <&clkc DVE>,
				 <&clkc HDMI_TX>;
			clock-names = "DISP_TGEN",
				      "DISP_DMIX",
				      "DISP_OSD0",
				      "DISP_GPOST0",
				      "DISP_VPOST",
				      "DISP_DDFCH",
				      "DISP_DVE",
				      "DISP_HDMI";
			resets = <&rstc RST_TGEN>,
				 <&rstc RST_DMIX>,
				 <&rstc RST_OSD0>,
				 <&rstc RST_GPOST0>,
				 <&rstc RST_VPOST>,
				 <&rstc RST_DDFCH>,
				 <&rstc RST_DVE>,
				 <&rstc RST_HDMI_TX>;
		};
```

## Documentation/devicetree/bindings/display/sunplus/sunplus,display.yaml
```yaml
# SPDX-License-Identifier: (GPL-2.0-only OR BSD-2-Clause)
# Copyright (C) Sunplus Co., Ltd. 2021
%YAML 1.2
---
$id: http://devicetree.org/schemas/display/sunplus/sunplus,display.yaml#
$schema: http://devicetree.org/meta-schemas/core.yaml#

title: Sunplus SoC Device-Tree bindings for display driver

maintainers:
  - Hammer Hsieh <hammer.hsieh@sunplus.com>

properties:
  compatible:
    items:
      - const: sunplus,sp7021-display

  reg:
    maxItems: 1

  interrupts:
    maxItems: 4

  clocks:
    maxItems: 8

  clock-names:
    items:
      - const: DISP_TGEN
      - const: DISP_DMIX
      - const: DISP_OSD0
      - const: DISP_GPOST0
      - const: DISP_VPOST
      - const: DISP_DDFCH
      - const: DISP_DVE
      - const: DISP_HDMI

  resets:
    maxItems: 8

required:
  - compatible
  - reg
  - interrupts
  - clocks
  - clock-names
  - resets

additionalProperties: false

examples:
  - |
    #include <dt-bindings/interrupt-controller/irq.h>
    #include <dt-bindings/interrupt-controller/sp-intc.h>
    #include <dt-bindings/clock/sp-sp7021.h>
    #include <dt-bindings/reset/sp-sp7021.h>

    sp_display: display@9c005c80 {
      compatible = "sunplus,sp7021-display";
      reg = <0x9c005c80 0x1980>;
      interrupt-parent = <&intc>;
      interrupts = <0 (IRQ_TYPE_EDGE_RISING | SP_INTC_EXT_INT1)>,
        <1 (IRQ_TYPE_EDGE_RISING | SP_INTC_EXT_INT1)>,
        <4 (IRQ_TYPE_EDGE_RISING | SP_INTC_EXT_INT1)>,
        <5 (IRQ_TYPE_EDGE_RISING | SP_INTC_EXT_INT1)>;
      clocks = <&clkc TGEN>,
        <&clkc DMIX>,
        <&clkc OSD0>,
        <&clkc GPOST0>,
        <&clkc VPOST>,
        <&clkc DDFCH>,
        <&clkc DVE>,
        <&clkc HDMI_TX>;
      clock-names = "DISP_TGEN",
        "DISP_DMIX",
        "DISP_OSD0",
        "DISP_GPOST0",
        "DISP_VPOST",
        "DISP_DDFCH",
        "DISP_DVE",
        "DISP_HDMI";
      resets = <&rstc RST_TGEN>,
        <&rstc RST_DMIX>,
        <&rstc RST_OSD0>,
        <&rstc RST_GPOST0>,
        <&rstc RST_VPOST>,
        <&rstc RST_DDFCH>,
        <&rstc RST_DVE>,
        <&rstc RST_HDMI_TX>;
    };
```

## Documentation/devicetree/bindings/display/sunplus/sunplus,fb.txt
```
Device-Tree bindings for fb driver

Required properties:
- compatible: Should be "sunplus,sp7021-fb"

Example:

		fb_device {
			compatible = "sunplus,sp7021-fb";
		};
```

## Documentation/devicetree/bindings/display/sunplus/sunplus,fb.yaml
```yaml
# SPDX-License-Identifier: (GPL-2.0-only OR BSD-2-Clause)
# Copyright (C) Sunplus Co., Ltd. 2021
%YAML 1.2
---
$id: http://devicetree.org/schemas/display/sunplus/sunplus,fb.yaml#
$schema: http://devicetree.org/meta-schemas/core.yaml#

title: Sunplus SoC Device-Tree bindings for fb driver

maintainers:
  - Hammer Hsieh <hammer.hsieh@sunplus.com>

properties:
  compatible:
    items:
      - const: sunplus,sp7021-fb

required:
  - compatible

additionalProperties: false

examples:
  - |
    fb_device {
      compatible = "sunplus,sp7021-fb";
    };
```

## Documentation/devicetree/bindings/display/sunplus/sunplus,hdmi.txt
```
Device-Tree bindings for hdmi driver

Required properties:
- compatible: Should be "sunplus,sp7021-hdmitx"
- clocks: Clock phandles (see clock-controller for details)
- resets: Reset phandles (see reset-controller for details)
- reg: Physical base address and length of the controller's register
- interrupt-parent: Interrupt phandles (see interrupt-controller for details)
- interrupts: interrupt number to the cpu.

Example:

	hdmitx: hdmitx@0x9C00BE00 {
		compatible = "sunplus,sp7021-hdmitx";
		clocks = <&clkc HDMI_TX>;
		resets = <&rstc RST_HDMI_TX>;
		reg = <0x9C00BE00 0x3FC>, <0x9C000200 0x80>, <0x9C000280 0x80>, <0x9C000080 0x80>;
		interrupt-parent = <&intc>;
		interrupts = <105 IRQ_TYPE_LEVEL_HIGH>;
	};
```

## Documentation/devicetree/bindings/display/sunplus/sunplus,sp7021-hdmitx.yaml
```yaml
# SPDX-License-Identifier: (GPL-2.0-only OR BSD-2-Clause)
# Copyright (C) Sunplus Co., Ltd. 2021
%YAML 1.2
---
$id: http://devicetree.org/schemas/display/sunplus/sunplus,sp7021-hdmitx.yaml#
$schema: http://devicetree.org/meta-schemas/core.yaml#

title: Sunplus SP7021 HDMITX Device Tree bindings

maintainers:
  - Vincent Shih <vincent.shih@sunplus.com>

properties:
  compatible:
    const: sunplus,sp7021-hdmitx

  clocks:
    maxItems: 1

  resets:
    maxItems: 1

  reg:
    maxItems: 3

  interrupts:
    maxItems: 1

  pinctrl-names:
    description: |
      Names corresponding to the numbered pinctrl states.
      A pinctrl state named "default" must be defined.
    const: default

  pinctrl-0:
    description: A handle to the 'default' state of pin configuration
    anyOf:
      - items:
          - description: node hdmi_A_tx1 for x1 mode

      - items:
          - description: node hdmi_A_tx2 for x2 mode

      - items:
          - description: node hdmi_A_tx3 for x3 mode

required:
  - compatible
  - clocks
  - resets
  - reg
  - interrupts
  - pinctrl-names
  - pinctrl-0

additionalProperties: false

examples:
  - |
    #include <dt-bindings/clock/sp-sp7021.h>
    #include <dt-bindings/reset/sp-sp7021.h>
    #include <dt-bindings/interrupt-controller/irq.h>

    hdmitx: hdmitx@9C00BE00 {
      compatible = "sunplus,sp7021-hdmitx";
      clocks = <&clkc HDMI_TX>;
      resets = <&rstc RST_HDMI_TX>;
      reg = <0x9C00BE00 0x3FC>, <0x9C000200 0x80>, <0x9C000280 0x80>;
      interrupt-parent = <&intc>;
      interrupts = <105 IRQ_TYPE_LEVEL_HIGH>;
      pinctrl-names = "default";
      pinctrl-0 = <&hdmi_A_tx1>;
    };
...
```

## Documentation/devicetree/bindings/dma/sunplus,cbdma.txt
```
Device-Tree bindings of sp_cbdma device

Required properties:
- compatible: Should be one of-
				"sunplus,cb-dma"
				"sunplus,cb-cdma"
- reg: Physical base address and length of the controller's register
- reg-names:  List of registers
- interrupt-parent: Interrupt phandles (see interrupt-controller for details)
- interrupts: interrupt number to the cpu.

Required child node properties:
- compatible:
	For CDMA: It should be "sunplus,sp7021-cb-cdma".
	For DMA: It should be either "sp,cb-dma-mm2s-channel"
	or "sp,cb-dma-s2mm-channel".
- interrupts: interrupt number to the cpu.
- sp,datawidth: Should contain the stream data width, take values
	{32,64...1024}.

Example:

	cbdma: cbdma@sp_cbdma {
		compatible = "sunplus,cb-cdma";
		reg = <0x9c000d00 0x80>;
		reg-names = "cb_dma";
		interrupt-parent = <&intc>;
		interrupts = <128 IRQ_TYPE_LEVEL_HIGH>;
		sp,addrwidth = <0x20>;
		dma-channel-0 {
			compatible = "sp,cb-cdma-channel";
			interrupts = <128 IRQ_TYPE_LEVEL_HIGH>;
			sp,datawidth = <0x20>;
		};
	};
```

## Documentation/devicetree/bindings/dma/sunplus,cbdma.yaml
```yaml
# SPDX-License-Identifier: (GPL-2.0-only OR BSD-2-Clause)
# Copyright (C) Sunplus Co., Ltd. 2021
%YAML 1.2
---
$id: http://devicetree.org/schemas/dma/sunplus,cbdma.yaml#
$schema: http://devicetree.org/meta-schemas/core.yaml#

title: Sunplus CB-DMA Controller Device Tree Bindings

maintainers:
  - Cheng Chung Ho <cc.ho@sunplus.com>

properties:
  compatible:
    enum:
      - sunplus,cb-dma
      - sunplus,cb-cdma

  reg:
    maxItems: 1

  reg-names:
    items:
      - const: cb_dma

  interrupts:
    maxItems: 1

  addrwidth:
    description: DMA addressing size in bits.
    enum:
      - 32
      - 64

patternProperties:
  '^.*$':
    if:
      type: object
    then:
      description: DMA channel nodes.

      properties:
        compatible:
          enum:
            - sunplus,cb-cdma-channel
            - sunplus,cb-dma-mm2s-channel
            - sunplus,cb-dma-s2mm-channel

        interrupts:
          maxItems: 1

        datawidth:
          description: The stream data width.
          minimum: 32
          maximum: 1024
          default: 32

      additionalProperties: false

additionalProperties: false

required:
  - compatible
  - reg
  - interrupts
  - addrwidth

examples:
  - |
    #include <dt-bindings/interrupt-controller/irq.h>
    #include <dt-bindings/clock/sp-sp7021.h>
    #include <dt-bindings/reset/sp-sp7021.h>
    cbdma: cbdma@9c000d00 {
        compatible = "sunplus,cb-cdma";
        reg = <0x9c000d00 0x80>;
        reg-names = "cb_dma";
        interrupt-parent = <&intc>;
        interrupts = <128 IRQ_TYPE_LEVEL_HIGH>;
        addrwidth = <0x20>;
        dma-channel-0 {
            compatible = "sunplus,cb-cdma-channel";
            interrupts = <128 IRQ_TYPE_LEVEL_HIGH>;
            datawidth = <0x20>;
        };
    };
...
```
