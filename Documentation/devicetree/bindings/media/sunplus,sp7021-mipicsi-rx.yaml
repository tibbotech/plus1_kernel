## Documentation/devicetree/bindings/pinctrl/sunplus,sp7021-pinctrl.txt
```
Sunplus SP7021 Pin Controller
-----------------------------

The Sunplus SP7021 pin controller is used to set up the function of a pin or a
pin-group.

Please refer to ../gpio/gpio.txt and ../interrupt-controller/interrupts.txt for
a general description of GPIO and interrupt bindings.

Please refer to pinctrl-bindings.txt in this directory for details of the
common pinctrl bindings used by client devices.

The device node of Sunplus SP7021 pin controller has following properties.

Required properties:
 - compatible: should be "sunplus,sp7021-pctl".
 - reg: addresses and length of the register sets for pin controller.
 - reg: base address and length of the pin controller.
 - gpio-controller: mark the device node as a gpio controller.
 - #gpio-cells: should be two.
 - clocks: clock selector for pin controller.
 - resets: reset controller selector for pin controller.

Each subnode lists and configures the pins.

	subnode {
		sppctl,groups = "GROPU_NAME";
		sppctl,function = "FUNCTION_NAME";
		sppctl,pins = < PIN_NUMBER_PINMUX >;
	};

Required properties in subnode:
 - sppctl,groups: name of pin-group.
 - sppctl,function: name of pin-function.
 - sppctl,pins: pin sets, please use macro SPPCTL_IOPAD to define each pin.

Example:

#include <dt-bindings/reset/sp-q628.h>
#include <dt-bindings/clock/sp-q628.h>
#include <dt-bindings/gpio/gpio.h>
#include <dt-bindings/pinctrl/sppctl-sp7021.h>

pctl: pctl@0x9C000100 {
	compatible = "sunplus,sp7021-pctl";
	reg = <0x9C000100 0x100>, <0x9C000300 0x80>, <0x9C000380 0x80>,
	      <0x9C0032e4 0x1C>, <0x9C000080 0x20>;
	gpio-controller;
	#gpio-cells = <2>;
	clocks = <&clkc GPIO>;
	resets = <&rstc RST_GPIO>;

	pins_uart0: pins_uart0 {
		sppctl,groups = "UA0";
		sppctl,function = "UA0";
	};

	emmc_mux: emmc_mux {
		sppctl,groups = "CARD0_EMMC";
		sppctl,function = "CARD0_EMMC";
	};

	mmc1_mux: mmc1_mux {
		sppctl,groups = "SD_CARD";
		sppctl,function = "SD_CARD";
		sppctl,pins = < SPPCTL_IOPAD(91,SPPCTL_PCTL_G_GPIO,0,0) >;
	};

	hdmi_A_tx1: hdmi_A_tx1_pins {
		sppctl,groups = "HDMI_TX1";
		sppctl,function = "HDMI_TX";
	};
	hdmi_A_tx2: hdmi_A_tx2_pins {
		sppctl,groups = "HDMI_TX2";
		sppctl,function = "HDMI_TX";
	};
	hdmi_A_tx3: hdmi_A_tx3_pins {
		sppctl,groups = "HDMI_TX3";
		sppctl,function = "HDMI_TX";
	};
};
```

## Documentation/devicetree/bindings/pinctrl/tibbo,sppctl.txt
```
---------------------------------------------
  SoC SunPlus/Tibbo SC7021 pinmux driver (sppctl)
---------------------------------------------

This document outlines the additional pin control subsystem available on 
SunPlus SC7021 SoC.

Available functions:

- list all peripheral functions that may be assigned
- individual and bulk pin-function assignment
- human-readable representation of the current pinmux mapping
- firmware dump and load

SC7021 platform has 64 pins and 120 different functions.

------
Files
------

The driver directory is /sys/devices/platform/soc@B/9c000100.sppctl.

Several files are created after driver initialization:

- dbgi (txt, read/write) - the debug level
  (0 - no debug, 1 - main messages, 2 - verbose)

- list_funcs (txt, read only) - full list of available functions in a 
  certain order
  (L2SW_CLK_OUT, L2SW_MAC_SMI_MDC,..., PWM0,..., SPIM0_INT, SPIM0_CLK, SPIM0_DO, 
  SPIM0_DI, etc.)

- txt_map (txt, read only) - human-readable pin assignment
  (for ex.: 040 L2SW_CLK_OUT - pin#40 assigned to L2SW_CLK_OUT function)

- fwname (txt, read/write) - firmware filename relative to /lib/firmware

- fw (bin, read/write) - firmware file

- 120 function-named files (bin, read/write)

---------
DTS file
---------

A driver is platform dependent, requested by DTS node.

Example:

        sppctl: sppctl@0x9C000100 {
                compatible = "sunplus,sppctl";
                reg = <0x9C000100 0x100>;
                fwname = "sppctl.bin";
        };

All properties are optional and has compile-time default values.

The compatible key may have one of the following values:

- pentagram,sppctl
- sunplus,sppctl
- tps,sppctl
- tibbo,sppctl

The reg key should contain 1 entry - the physical address and length of the 
sppctl registers.

The fwname define a path to the firmware relative to /lib/firmware.

--------------
Firmware file
--------------

At driver start-up loads default pins layout from firmware file defined in 
DTS file.

The lack of firmware does not affect the functionality.

The firmware may be applied in two ways:

- to write a file name into /sys/devices/platform/soc@B/9c000100.sppctl/fwname
- to write binary pinmux data into /sys/devices/platform/soc@B/9c000100.sppctl/fw

The firmware file must be at least 120 bytes (1 byte per function). All 
bytes after 120'th will be ignored. The data must be written in binary form.
Each byte is the pin number.

Functions are listed in file "list_funcs" in the certain order.
For example byte#0 - L2SW_CLK_OUT, byte#1 - L2SW_MAC_SMI_MDC etc. 
Byte#0 = 0x10 means, that pin #16 (0x10 in hex) assigned to function 
L2SW_CLK_OUT (position #0 in list_funcs).
0x00 in position #0 means no pin is assigned to L2SW_MAC_SMI_MDC function.

-------------------
Pins configuration
-------------------

File txt_map is the human-readable format of the current pinmux mapping.
Cut from this file:

040 L2SW_CLK_OUT
034 L2SW_MAC_SMI_MDC
035 L2SW_LED_FLASH0

Legend:
Pin #40 assigned to L2SW_CLK_OUT function,
pin #34 assigned to L2SW_MAC_SMI_MDC,
pin #35 assigned to L2SW_LED_FLASH0, etc.

Alternatively, you can read the binary 1-byte value from function files, i.e.
L2SW_CLK_OUT, L2SW_MAC_SMI_MDC, L2SW_LED_FLASH0 etc. from the driver directory.

To assign certain function to a pin one-byte value must be written to the function file.
For ex., to assign pin #1 (G_MX8) to L2SW_LED_ON0 function:

# echo -e "\01" > /sys/device/platform/soc@B/9c000100/L2SW_LED_ON0.
```

## Documentation/devicetree/bindings/pwm/pwm-sunplus.txt
```
Sunplus SoC PWM driver bindings
--------------------------------------

Required parameters:
- compatible :	"sunplus,sp7021-pwm" or "sunplus,q645-pwm"
- #pwm-cells :	Number of cells used to specify a PWM. First cell
			specifies the per-chip index of the PWM to use and the
			second cell is the period in nanoseconds - fixed to 2.
- reg :	Physical base address and length of the controller's
		registers.
- clocks : Clock phandles (see clock-controller for details).
- resets : Reset phandles (see reset-controller for details).
- pinctrl-names: 	Set to "default".
- pinctrl-0:	List of phandles pointing to pin configuration nodes
			for PWM module.

Optional properties:
- none

Example1:

		pwm: pwm@0x9c007a00 {
			#pwm-cells = <2>;
			compatible = "sunplus,sp7021-pwm";
			reg = <0x9c007a00 0x80>;
			clocks = <&clkc DISP_PWM>;
			resets = <&rstc RST_DISP_PWM>;
			pinctrl-names = "default";
			pinctrl-0 = <&pins_pwm>;
		};

		pctl: pctl@0x9C000100 {
			compatible = "sunplus,sp7021-pctl";
			reg = <0x9C000100 0x100>, <0x9C000300 0x80>, <0x9C000380 0x80>, <0x9C0032e4 0x1C>, <0x9C000080 0x20>;
			gpio-controller;
			#gpio-cells = <2>;
			clocks = <&clkc GPIO>;
			resets = <&rstc RST_GPIO>;

			pins_pwm: pins_pwm {
				sppctl,pins = <
					SPPCTL_IOPAD(1,SPPCTL_PCTL_G_PMUX,MUXF_PWM0,0)
					SPPCTL_IOPAD(2,SPPCTL_PCTL_G_PMUX,MUXF_PWM1,0)
					SPPCTL_IOPAD(3,SPPCTL_PCTL_G_PMUX,MUXF_PWM2,0)
					SPPCTL_IOPAD(4,SPPCTL_PCTL_G_PMUX,MUXF_PWM3,0)
					SPPCTL_IOPAD(5,SPPCTL_PCTL_G_PMUX,MUXF_PWM4,0)
					SPPCTL_IOPAD(6,SPPCTL_PCTL_G_PMUX,MUXF_PWM5,0)
					SPPCTL_IOPAD(7,SPPCTL_PCTL_G_PMUX,MUXF_PWM6,0)
					SPPCTL_IOPAD(8,SPPCTL_PCTL_G_PMUX,MUXF_PWM7,0)
				>;
			};
		};

Example2:

	pwm: pwm@0xf8008f80 {
		#pwm-cells = <2>;
		compatible = "sunplus,q645-pwm";
		reg = <0x0 0xf8008f80 0x0 0x100>;
		clocks = <&clkc DISP_PWM>;
		resets = <&rstc RST_DISP_PWM>;
	};

	pctl: pctl@0xf8000100 {
		compatible = "sunplus,q645-pctl";
		reg = <0x0 0xf8000100 0x0 0x100>,
		      <0x0 0xf8000280 0x0 0x180>,
		      <0x0 0xf80032e4 0x0 0x1c>,
		      <0x0 0xf8000080 0x0 0x20>;
		gpio-controller;
		#gpio-cells = <2>;

		pwm_pins: pinmux_pwm_pins {
			sppctl,function = "PWM";
			sppctl,groups = "PWM";
		};
	};
```

## Documentation/devicetree/bindings/remoteproc/sunplus,sp-rproc.yaml
```yaml
# SPDX-License-Identifier: (GPL-2.0-only or BSD-2-Clause)
%YAML 1.2
---
$id: http://devicetree.org/schemas/remoteproc/sunplus,sp-rproc.yaml#
$schema: http://devicetree.org/meta-schemas/core.yaml#

title: Sunplus Soc Co-Processor Bindings

maintainers:
  - Qin Jian <qinjian@cqplus1.com>

properties:
  compatible:
    const: sunplus,sp-rproc

  firmware:
    description: |
      Should contain the name of the default firmware image
      file located on the firmware search path

  reg:
    maxItems: 2

  interrupts:
    maxItems: 1

  resets:
    maxItems: 1

  memory-region:
    minItems: 4
    maxItems: 8
    description: |
      phandle to the reserved memory nodes to be associated with the remoteproc
      device. There should be at least four reserved memory nodes defined. The
      reserved memory nodes should be carveout nodes, and should be defined as
      per the bindings in
      Documentation/devicetree/bindings/reserved-memory/reserved-memory.txt
    items:
      - description: region used for dynamic DMA allocations like vrings and
                     vring buffers
      - description: region reserved for firmware image sections
    additionalItems: true

required:
  - compatible
  - firmware
  - reg
  - interrupts
  - resets
  - memory-region

additionalProperties: true

examples:
  - |
    #include <dt-bindings/interrupt-controller/irq.h>
    #include <dt-bindings/reset/sp-sp7021.h>

    remoteproc0: remoteproc@9c00817c {
      compatible = "sunplus,sp-rproc";
      firmware = "firmware";
      reg = <0x9c00817c 4>, /* mbox G258.31 */
            <0x9e809ff8 4>; /* boot A926 */
      interrupt-parent = <&intc>;
      interrupts = <189 IRQ_TYPE_EDGE_RISING>; /* ACHIPCPU0_DIRECT_INT7 */
      resets = <&rstc RST_A926>;
      memory-region = <&rproc_0_reserved>, <&vdev0buffer>, <&vdev0vring0>, <&vdev0vring1>;
    };
...
```

## Documentation/devicetree/bindings/remoteproc/sunplus,sp_remoteproc.txt
```
Sunplus Soc Co-Processor Bindings

This binding provides support for ARM926/Cortex M4 Co-processor found on some
Sunplus SoCs.

Required properties:
- compatible ：Should contain entries for this and backward compatible
- reg : Offset and length of the register set for the device
- interrupt-parent : phandle to the parent interrupt controller.
- interrupts : the device's interrupt number
- resets : phandles to the reset lines needed for this power demain sequence
	as described in ../reset/reset.txt
- memory-region : Reserved memory (See: ../reserved-memory/reserved-memory.txt)

Optional properties:
- firmware : Co-processor firmware filename

Example:

	remoteproc0: remoteproc@0 {
		compatible = "sunplus,sp_remoteproc";
		firmware = "firmware";
		reg = <0 0xf8007ffc 0 4>; /* mbox G255.31, cpu0 to cpu2 direct reg07 */
		interrupt-parent = <&gic>;
		interrupts = <GIC_SPI 125 IRQ_TYPE_LEVEL_HIGH>; /* CPU2_TO_0_DIRECT_INT7 */
		resets = <&rstc RST_CM4>;
		memory-region = <&rproc_0_reserved>, <&vdev0buffer>, <&vdev0vring0>, <&vdev0vring1>;
	};
```
