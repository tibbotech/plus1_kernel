## Documentation/devicetree/bindings/media/sunplus,sp7021-mipicsi-rx.yaml
```yaml
# SPDX-License-Identifier: (GPL-2.0-only OR BSD-2-Clause)
# Copyright (C) Sunplus Co., Ltd. 2021
%YAML 1.2
---
$id: http://devicetree.org/schemas/media/sunplus,sp7021-mipicsi-rx.yaml#
$schema: http://devicetree.org/meta-schemas/core.yaml#

title: Sunplus SP7021 MIPI-CSI RX Controller Device Tree Bindings

maintainers:
  - Cheng Chung Ho <cc.ho@sunplus.com>

properties:
  compatible:
    items:
      - const: sunplus,sp7021-mipicsi-rx

  reg:
    maxItems: 2

  reg-names:
    items:
      - const: mipicsi
      - const: csiiw

  interrupts:
    maxItems: 2

  clocks:
    maxItems: 2

  clock-names:
    items:
      - const: clk_mipicsi
      - const: clk_csiiw

  resets:
    maxItems: 2

  reset-names:
    items:
      - const: rstc_mipicsi
      - const: rstc_csiiw

  i2c-id:
    description: The channel number of I2C.
    minimum: 0
    maximum: 3
    default: 1

  pinctrl-names:
    description: |
      Names corresponding to the numbered pinctrl states.
      A pinctrl state named "default" must be defined.
    const: default

  pinctrl-0:
    description: A handle to the 'default' state of pin configuration.

additionalProperties: false

required:
  - compatible
  - reg
  - interrupts
  - clocks
  - resets
  - i2c-id
  - pinctrl-names
  - pinctrl-0

examples:
  - |
    #include <dt-bindings/interrupt-controller/irq.h>
    #include <dt-bindings/clock/sp-sp7021.h>
    #include <dt-bindings/reset/sp-sp7021.h>
    mipicsi0: mipicsirx@9C005280 {
        compatible = "sunplus,sp7021-mipicsi-rx";
        reg = <0x9C005280 0x80>, <0x9C005300 0x80>;
        reg-names = "mipicsi", "csiiw";
        interrupt-parent = <&intc>;
        interrupts = <49 IRQ_TYPE_EDGE_RISING>, <50 IRQ_TYPE_EDGE_RISING>;
        clocks = <&clkc MIPICSI0>, <&clkc CSIIW0>;
        clock-names = "clk_mipicsi", "clk_csiiw";
        resets = <&rstc RST_MIPICSI0>, <&rstc RST_CSIIW0>;
        reset-names = "rstc_mipicsi", "rstc_csiiw";
        i2c-id = <1>;
        pinctrl-names = "default";
        pinctrl-0 = <&mipicsi0_pins>;
    };
...
```

## Documentation/devicetree/bindings/misc/sunplus-icm.txt
```
* Sunplus SP7021 ICM IP *

The SP7021 ICM IP block which provides input capture module Code implementations.

Required properties:
- compatible: Must be "sunplus,sp7021-icm"
- clocks : Clock phandles (see clock-controller for details).
- resets : Reset phandles (see reset-controller for details).
- reg: Should contain Sunplus SP7021 ICM IP block registers
  location and length.
- interrupt-parent: interrupt phandles(see interrupt-controller for details).
- interrupts: should contain SP7021 interrupt number
Optional properties:
- none

Example
---------------------------------------
  icm: icm@0x9C002880 {
    compatible = "sunplus,sp7021-icm";
    clocks = <&clkc ICM>;
    resets = <&rstc RST_ICM>;
    reg = <0x9c002880 0x80>;
    interrupt-parent = <&intc>;
    interrupts =
      <92 IRQ_TYPE_EDGE_RISING>, /* icm0 */
      <93 IRQ_TYPE_EDGE_RISING>, /* icm1 */
      <94 IRQ_TYPE_EDGE_RISING>, /* icm2 */
      <95 IRQ_TYPE_EDGE_RISING>; /* icm3 */
  };
```

## Documentation/devicetree/bindings/misc/sunplus-icm.yaml
```yaml
# SPDX-License-Identifier: (GPL-2.0-only OR BSD-2-Clause)
# Copyright (C) Sunplus Co., Ltd. 2021
%YAML 1.2
---
$id: http://devicetree.org/schemas/misc/sunplus-icm.yaml#
$schema: http://devicetree.org/meta-schemas/core.yaml#

title: Sunplus SoC ICM(Input Capture Module) Controller

maintainers:
  - Hammer Hsieh <hammer.hsieh@sunplus.com>

properties:
  compatible:
    items:
      - const: sunplus,sp7021-icm

  reg:
    maxItems: 1

  clocks:
    maxItems: 1

  resets:
    maxItems: 1

  interrupts:
    maxItems: 4

required:
  - compatible
  - reg
  - clocks
  - resets
  - interrupts

additionalProperties: false

examples:
  - |
    #include <dt-bindings/interrupt-controller/irq.h>
    #include <dt-bindings/clock/sp-sp7021.h>
    #include <dt-bindings/reset/sp-sp7021.h>

    icm: icm@9C002880 {
      compatible = "sunplus,sp7021-icm";
      clocks = <&clkc ICM>;
      resets = <&rstc RST_ICM>;
      reg = <0x9c002880 0x80>;
      interrupt-parent = <&intc>;
      interrupts =
        <92 IRQ_TYPE_EDGE_RISING>, /* icm0 */
        <93 IRQ_TYPE_EDGE_RISING>, /* icm1 */
        <94 IRQ_TYPE_EDGE_RISING>, /* icm2 */
        <95 IRQ_TYPE_EDGE_RISING>; /* icm3 */
    };
```

## Documentation/devicetree/bindings/misc/sunplus-iop.txt
```
* Sunplus SP7021 IOP(8051) *

This file documents the properties used by the sunplus_iop(8051) driver.

Required properties:
- compatible:
 Should be "sunplus,sp7021-iop": for sp7021
 Should be "sunplus,q645-iop": for q645

Optional properties:

Example:
	iop: iop@sp_iop {
		compatible = "sunplus,sp7021-iop";
		reg = <0x9c000400 0x80>, <0x9c000000 0x80>, <0x9c000F00 0x80>, <0x9c003100 0x80>, <0x9c012B80 0x80>;
		reg-names = "iop", "iop_moon0", "iop_qctl", "iop_pmc", "axi_mon";
		interrupt-parent = <&intc>;
		interrupts = <41 IRQ_TYPE_LEVEL_HIGH>, <42 IRQ_TYPE_LEVEL_HIGH>;
		memory-region = <&iop_reserve>;
	};

	iop: iop@0xf8000400 {
		compatible = "sunplus,q645-iop";
		reg = <0x0 0xf8000400 0x0 0x80>, <0x0 0xf8000000 0x0 0x80>, <0x0 0xf8000F00 0x0 0x80>, <0x0 0xf8003100 0x0 0x80>, <0x0 0xf8012B80 0x0 0x80>;
		interrupt-parent = <&gic>;
		interrupts = <GIC_SPI 58 IRQ_TYPE_LEVEL_HIGH>, <GIC_SPI 59 IRQ_TYPE_LEVEL_HIGH>;
		reg-names = "iop", "iop_moon0", "iop_qctl", "iop_pmc", "axi_mon";
		memory-region = <&iop_reserve>;
	};
```

## Documentation/devicetree/bindings/mmc/sunplus-sd.txt
```
* Sunplus SD/SDIO controller *

The Sunplus SD/SDIO controllerbto support  SD, and SDIO 

This file documents the properties used by the Sunplus SD/SDIO driver.

Required properties:
- compatible:
 Should be "sunplus,q645-card":   for SD q645
 Should be "sunplus,q645-sdio":   for SDIO q645
 Should be "sunplus,i143-card1":  for SD i143
 Should be "sunplus,i143-sdio":   for SDIO i143

Optional properties:
- max-frequency: Maximum operating clock frequency, default 52MHz.

Example:
	mmc1: mmc@0xf8003e80 {
		compatible = "sunplus,q645-card";
		reg = <0x0 0xf8003e80 0x0 0x180>;
		interrupt-parent = <&gic>;
		interrupts = <GIC_SPI 16 IRQ_TYPE_LEVEL_HIGH>;
		clocks = <&clkc CARD_CTL1>;
		resets = <&rstc RST_CARD_CTL1>;
		pinctrl-names = "default";
		pinctrl-0 = <&sdcard_pins>;
		cd-gpios = <&pctl 62 GPIO_ACTIVE_LOW>;
		bus-width = <4>;
		max-frequency = <52000000>;
		disable-wp;
		cap-sd-highspeed;
		no-sdio;
		no-mmc;
	};

	sdio: sdio@0xf8008400 {
		compatible = "sunplus,q645-sdio";
		reg = < 0x0 0xf8008400 0x0 0x180>;
		interrupt-parent = <&gic>;
		interrupts = <GIC_SPI 15 IRQ_TYPE_LEVEL_HIGH>;
		clocks = <&clkc CARD_CTL2>;
		resets = <&rstc RST_CARD_CTL2>;
		pinctrl-names = "default";
		pinctrl-0 = <&sdio_pins>;
		bus-width = <4>;
		max-frequency = <52000000>;
		non-removable;
		disable-wp;
		cap-sd-highspeed;
		cap-sdio-irq;
		no-sd;
		no-mmc;
		#address-cells = <1>;
		#size-cells = <0>;
		status = "disabled";
	};
```

## Documentation/devicetree/bindings/mmc/sunplus-sd2.yaml
```yaml
# SPDX-License-Identifier: GPL-2.0
%YAML 1.2
---
$id: http://devicetree.org/schemas/mmc/sunplus-sd2.yaml#
$schema: http://devicetree.org/meta-schemas/core.yaml#

title: Sunplus SD/SDIO controller

maintainers:
  - lh.kuo <lh.kuo@sunplus.com>

allOf:
  - $ref: mmc-controller.yaml#

properties:
  compatible:
    enum:
      - sunplus,sp7021-card1
      - sunplus,sp7021-sdio

  reg:
    maxItems: 1

  interrupts:
    maxItems: 1

  clocks:
    maxItems: 1

  resets:
    maxItems: 1

required:
  - compatible
  - reg
  - interrupts
  - clocks
  - resets


examples:
  - |
	mmc1: mmc@sdcard {
		compatible = "sunplus,sp7021-card1";
		reg = <0x9c003e80 0x280>;
		interrupts = <21 IRQ_TYPE_LEVEL_HIGH>;
		clocks = <&clkc CARD_CTL1>;
		resets = <&rstc RST_CARD_CTL1>;
		bus-width = <4>;
		max-frequency = <52000000>;
		disable-wp;
		cap-sd-highspeed;
		no-sdio;
		no-mmc;
	};

	sdio: sdio@sdcard {
		compatible = "sunplus,sp7021-sdio";
		reg = <0x9c008400 0x280>;
		interrupts = <22 IRQ_TYPE_LEVEL_HIGH>;
		clocks = <&clkc CARD_CTL4>;
		resets = <&rstc RST_CARD_CTL4>;
		bus-width = <4>;
		max-frequency = <52000000>;
		non-removable;
		disable-wp;
		cap-sd-highspeed;
		cap-sdio-irq;
		no-sd;
		no-mmc;
		#address-cells = <1>;
		#size-cells = <0>;
	};	
```

## Documentation/devicetree/bindings/mmc/sunplus-sd3.yaml
```yaml
# SPDX-License-Identifier: (GPL-2.0 OR BSD-2-Clause)
%YAML 1.2
---
$id: http://devicetree.org/schemas/mmc/sunplus-sd3.yaml#
$schema: http://devicetree.org/meta-schemas/core.yaml#

title: Sunplus SD/SDIO controller

maintainers:
  - lh.kuo <lh.kuo@sunplus.com>

allOf:
  - $ref: mmc-controller.yaml#

properties:
  compatible:
    enum:
      - sunplus,q645-card
      - sunplus,q645-sdio

  reg:
    maxItems: 1

  interrupts:
    maxItems: 1

  clocks:
    maxItems: 1

  resets:
    maxItems: 1

required:
  - compatible
  - reg
  - interrupts
  - clocks
  - resets


examples:
  - |
        mmc1: mmc@0xf8003e80 {
                compatible = sunplus,q645-card";
                reg = <0x0 0xf8003e80 0x0 0x180>;
                interrupt-parent = <&gic>;
                interrupts = <GIC_SPI 16 IRQ_TYPE_LEVEL_HIGH>;
                clocks = <&clkc CARD_CTL1>;
                resets = <&rstc RST_CARD_CTL1>;
                pinctrl-names = "default";
                pinctrl-0 = <&sdcard_pins>;
                cd-gpios = <&pctl 62 GPIO_ACTIVE_LOW>;
                bus-width = <4>;
                max-frequency = <52000000>;
                disable-wp;
                cap-sd-highspeed;
                no-sdio;
                no-mmc;
        };
        sdio: sdio@0xf8008400 {
                compatible = "sunplus,q645-sdio";
                reg = < 0x0 0xf8008400 0x0 0x180>;
                interrupts = <GIC_SPI 15 IRQ_TYPE_LEVEL_HIGH>;
                clocks = <&clkc CARD_CTL2>;
                resets = <&rstc RST_CARD_CTL2>;
                pinctrl-names = "default";
                pinctrl-0 = <&sdio_pins>;
                bus-width = <4>;
                max-frequency = <52000000>;
                non-removable;
                disable-wp;
                cap-sd-highspeed;
                cap-sdio-irq;
                no-sd;
                no-mmc;
        };
...
```

## Documentation/devicetree/bindings/mmc/sunplus-sp7021-sd.txt
```
* Sunplus SP7021 SD/SDIO controller *

The Sunplus SD/SDIO controllerbto support  SD, and SDIO 

This file documents the properties used by the Sunplus SP7021 SD/SDIO driver.

Required properties:
- compatible:
 Should be "sunplus,sp7021-card1": for SD   sp7021
 Should be "sunplus,sp7021-sdio":  for SDIO sp7021

Optional properties:
- max-frequency: Maximum operating clock frequency, default 52MHz.

Example:
	mmc1: mmc@sdcard {
		compatible = "sunplus,sp7021-card1";
		reg = <0x9c003e80 0x280>;
		interrupts = <21 IRQ_TYPE_LEVEL_HIGH>;
		clocks = <&clkc CARD_CTL1>;
		resets = <&rstc RST_CARD_CTL1>;
		bus-width = <4>;
		max-frequency = <52000000>;
		disable-wp;
		cap-sd-highspeed;
		no-sdio;
		no-mmc;
	};

	sdio: sdio@sdcard {
		compatible = "sunplus,sp7021-sdio";
		reg = <0x9c008400 0x280>;
		interrupts = <22 IRQ_TYPE_LEVEL_HIGH>;
		clocks = <&clkc CARD_CTL4>;
		resets = <&rstc RST_CARD_CTL4>;
		bus-width = <4>;
		max-frequency = <52000000>;
		non-removable;
		disable-wp;
		cap-sd-highspeed;
		cap-sdio-irq;
		no-sd;
		no-mmc;
		#address-cells = <1>;
		#size-cells = <0>;
	};	
```

## Documentation/devicetree/bindings/mmc/sunplus_mmc.txt
```
* Sunplus SP7021 MMC IP *

This file documents the properties used by the sunplus_mmc driver.

Required properties:
- compatible:
 Should be "sunplus,sp7021-emmc": for sp7021
 Should be "sunplus,i143-emmc": for i143
 Should be "sunplus,q645-emmc": for q645

Optional properties:
- max-frequency: Maximum operating clock frequency, default 52MHz.

Example:
mmc0: mmc@emmc {
	compatible = "sunplus,sp7021-emmc";
	reg = <0x9c003b00 0x180>;
	interrupts = <20 IRQ_TYPE_LEVEL_HIGH>;
	clocks = <&clkc CARD_CTL0>;
	resets = <&rstc RST_CARD_CTL0>;
	bus-width = <8>;
	max-frequency = <52000000>;
	non-removable;
	disable-wp;
	cap-mmc-highspeed;
	mmc-ddr-3_3v;
	no-sdio;
	no-sd;
};
```

## Documentation/devicetree/bindings/mtd/sunplus,bch.txt
```
Device-Tree bindings of sp_bch device

Required properties:
- compatible: Should be
				"sunplus,sunplus,sp7021-bch" for bch of sp7021
				"sunplus,sunplus,q645-bch" for bch of q645
- reg: Physical base address and length of the controller's register
- interrupt-parent: Interrupt phandles (see interrupt-controller for details)
- interrupts: interrupt number to the cpu.
- clocks: Clock phandles (see clock-controller for details)
- resets: Reset phandles (see reset-controller for details)

Example:

	bch0: bch@sp_bch {
		compatible = "sunplus,sp7021-bch";
		reg = <0x9c101000 0x20>;
		interrupt-parent = <&intc>;
		interrupts = <58 IRQ_TYPE_LEVEL_HIGH>;
		clocks = <&clkc BCH>;
		resets = <&rstc RST_BCH>;
	};
```

## Documentation/devicetree/bindings/mtd/sunplus,bch.yaml
```yaml
# SPDX-License-Identifier: (GPL-2.0-only OR BSD-2-Clause)
# Copyright (C) Sunplus Co., Ltd. 2021
%YAML 1.2
---
$id: http://devicetree.org/schemas/mtd/sunplus,bch.yaml#
$schema: http://devicetree.org/meta-schemas/core.yaml#

title: Sunplus BCH Engine Device Tree Bindings

maintainers:
  - Cheng Chung Ho <cc.ho@sunplus.com>

properties:
  compatible:
    enum:
      - sunplus,sp7021-bch
      - sunplus,q645-bch

  reg:
    maxItems: 1

  interrupts:
    maxItems: 1

  clocks:
    maxItems: 1

  resets:
    maxItems: 1

additionalProperties: false

required:
  - compatible
  - reg
  - interrupts
  - clocks
  - resets

examples:
  - |
    #include <dt-bindings/interrupt-controller/irq.h>
    #include <dt-bindings/clock/sp-sp7021.h>
    #include <dt-bindings/reset/sp-sp7021.h>
    bch0: bch@9C101000 {
        compatible = "sunplus,sp7021-bch";
        reg = <0x9C101000 0x20>;
        interrupt-parent = <&intc>;
        interrupts = <58 IRQ_TYPE_LEVEL_HIGH>;
        clocks = <&clkc BCH>;
        resets = <&rstc RST_BCH>;
    };
...
```

## Documentation/devicetree/bindings/mtd/sunplus,spinand.txt
```
Device-Tree bindings of sp_spinand device

Required properties:
- compatible: Should be
				"sunplus,sunplus,sp7021-spinand" for bch of sp7021
				"sunplus,sunplus,q645-spi-nand" for bch of q645
- reg: Physical base address and length of the controller's register
- interrupt-parent: Interrupt phandles (see interrupt-controller for details)
- interrupts: Interrupt number to the cpu.
- clocks: Clock phandles (see clock-controller for details)
- resets: Reset phandles (see reset-controller for details)
- spinand-clk-div: The settings of SPI interface clock frequency division
	The range of the frequency division setting is from 1 to 7. The CLK_SPI is
	the SPI-NAND source clock. It takes following values:
	For SP7021. The frequency of CLK_SPI is 202.5 MHz.
	{1}, CLK_SPI/2  = 101.250 MHz
	{2}, CLK_SPI/4  =  50.625 MHz
	{3}, CLK_SPI/6  =  33.750 MHz
	{4}, CLK_SPI/8  =  25.313 MHz
	{5}, CLK_SPI/16 =  12.656 MHz
	{6}, CLK_SPI/24 =   8.438 MHz
	{7}, CLK_SPI/32 =   6.328 MHz
	For Q645. The frequency of CLK_SPI is 600.0 MHz.
	{1}, CLK_SPI/2  = 300.000 MHz
	{2}, CLK_SPI/4  = 150.000 MHz
	{3}, CLK_SPI/6  = 100.000 MHz
	{4}, CLK_SPI/8  =  75.000 MHz
	{5}, CLK_SPI/16 =  37.500 MHz
	{6}, CLK_SPI/24 =  25.000 MHz
	{7}, CLK_SPI/32 =  18.750 MHz

Example:

	spinand0: spinand@sp_spinand {
		compatible = "sunplus,sp7021-spinand";
		reg = <0x9c002B80 0x50>;
		interrupt-parent = <&intc>;
		interrupts = <149 IRQ_TYPE_LEVEL_HIGH>;
		clocks = <&clkc SPIND>;
		resets = <&rstc RST_SPIND>;
		spinand-clk-div = <1>;
	};
```
