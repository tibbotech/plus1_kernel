## Documentation/devicetree/bindings/mtd/sunplus,spinand.yaml
```yaml
# SPDX-License-Identifier: (GPL-2.0-only OR BSD-2-Clause)
# Copyright (C) Sunplus Co., Ltd. 2021
%YAML 1.2
---
$id: http://devicetree.org/schemas/mtd/sunplus,spinand.yaml#
$schema: http://devicetree.org/meta-schemas/core.yaml#

title: Sunplus SPI-NAND Controller Device Tree Bindings

maintainers:
  - Cheng Chung Ho <cc.ho@sunplus.com>

properties:
  compatible:
    enum:
      - sunplus,sp7021-spinand
      - sunplus,q645-spi-nand

  reg:
    maxItems: 1

  interrupts:
    maxItems: 1

  clocks:
    maxItems: 1

  resets:
    maxItems: 1

  pinctrl-names:
    description: |
      Names corresponding to the numbered pinctrl states.
      A pinctrl state named "default" must be defined.
    const: default

  pinctrl-0:
    description: A handle to the 'default' state of pin configuration
  
  spi-max-frequency:
    description: The maximum operating frequency of SPI NAND flash.
    minimum: 6000000
    maximum: 300000000
    default: 50000000

additionalProperties: false

required:
  - compatible
  - reg
  - interrupts
  - clocks
  - resets
  - pinctrl-names
  - pinctrl-0
  - spi-max-frequency

examples:
  - |
    #include <dt-bindings/interrupt-controller/irq.h>
    #include <dt-bindings/clock/sp-sp7021.h>
    #include <dt-bindings/reset/sp-sp7021.h>
    spinand0: spinand@9C002B80 {
        compatible = "sunplus,sp7021-spinand";
        reg = <0x9C002B80 0x50>;
        interrupt-parent = <&intc>;
        interrupts = <149 IRQ_TYPE_LEVEL_HIGH>;
        clocks = <&clkc SPIND>;
        resets = <&rstc RST_SPIND>;
        pinctrl-names = "default";
        pinctrl-0 = <&pins_spinand0>;
        spi-max-frequency = <110000000>;
    };
...
```

## Documentation/devicetree/bindings/mtd/sunplus,spinor.txt
```
Sunplus SPI NOR flash controller
--------------------------------

The device node of Sunplus SPI NOR flash controller has following properties.

Required properties:
 - compatible: should be "sunplus,sp-spi-nor".
 - reg: addresses and length of the register sets for SPI-NOR flash controller.
 - interrupt-parent: phandle for interrupt parent.
 - interrupts: number and type of interrupt, type should be high-level.
 - clocks: clock selector for SPI-NOR flash controller.
 - resets: reset controller selector for SPI-NOR flash controller.
 - spi-max-frequency: Maximum frequency of the SPI bus the chip can operate at.
 - spi-chip-selection: Selection of chip of SPI-NOR chip.
 - read-timing-selection: timing adjust for read.
 - write-timing-selection: timeing adjust for write.
 - pinctrl-names: Names corresponding to the numbered pinctrl states.
 - pinctrl-0: phandle for the 'default' state of pin configuration.

Example:

sp_spinor0: spinor@9C000B00 {
	compatible = "sunplus,sp-spi-nor";
	reg = <0x9C000B00 0x80>, <0x9c000080 0x80>;
	interrupt-parent = <&intc>;
	interrupts = <143 IRQ_TYPE_LEVEL_HIGH>;
	clocks = <&clkc SPIFL>;
	resets = <&rstc RST_SPIFL>;
	spi-max-frequency = <50000000>;
	spi-chip-selection = <0>;
	read-timing-selection = <1>;
	write-timing-selection = <1>;
	pinctrl-names = "default";
	pinctrl-0 = <&spi_flash2_mux &spi_fla4b2_mux>;
};
```

## Documentation/devicetree/bindings/mtd/sunplus,spinor.yaml
```yaml
# SPDX-License-Identifier: (GPL-2.0-only OR BSD-2-Clause)
# Copyright (C) Sunplus Co., Ltd. 2021
%YAML 1.2
---
$id: http://devicetree.org/schemas/mtd/sunplus,spinor.yaml#
$schema: http://devicetree.org/meta-schemas/core.yaml#

title: Sunplus SPI NOR flash controller Device Tree Bindings

maintainers:
  - Wells Lu <wells.lu@sunplus.com>

description: |
  Sunplus SPI NOR flash controller.
  The device node of Sunplus SPI NOR flash controller has following properties.

properties:
  compatible:
    items:
      - const: sunplus,sp-spi-nor

  reg:
    items:
      - description: Base address and length of the SPI registers.
      - description: Base address and length of the MOON1 registers.

  interrupts:
    description: |
      Contains number and type of interrupt. Number should be 143.
      Type should be high-level trigger
    maxItems: 1

  clocks:
    description: |
      Clock controller selector for SPI NOR flash controller.
    maxItems: 1

  resets:
    description: |
      Reset controller selector for SPI NOR flash controller.
    maxItems: 1

  pinctrl-names:
    description: |
      Names corresponding to the numbered pinctrl states.
      A pinctrl state named "default" must be defined.
    const: default

  pinctrl-0:
    description: A handle to the 'default' state of pin configuration

  spi-max-frequency:
    description: The maximum operating frequency of SPI NOR flash.
    minimum: 1000000
    maximum: 50000000
    default: 50000000

  spi-chip-selection:
    description: Chip select of SPI NOR flash
    const: 0

  read-timing-selection:
    description: Read timing adjustment value
    $ref: /schemas/types.yaml#/definitions/uint32
    minimum: 0
    maximum: 7
    default: 1

  write-timing-selection:
    description: Write timing adjustment value
    $ref: /schemas/types.yaml#/definitions/uint32
    minimum: 0
    maximum: 1
    default: 1

additionalProperties: false

required:
  - compatible
  - reg
  - interrupts
  - clocks
  - resets
  - pinctrl-names
  - pinctrl-0
  - spi-max-frequency
  - spi-chip-selection
  - read-timing-selection
  - write-timing-selection

examples:
  - |
    #include <dt-bindings/interrupt-controller/irq.h>
    #include <dt-bindings/clock/sp-sp7021.h>
    #include <dt-bindings/reset/sp-sp7021.h>
    sp_spinor0: spinor@9C000B00 {
        compatible = "sunplus,sp-spi-nor";
        reg = <0x9C000B00 0x80>, <0x9c000080 0x80>;
        interrupt-parent = <&intc>;
        interrupts = <143 IRQ_TYPE_LEVEL_HIGH>;
        clocks = <&clkc SPIFL>;
        resets = <&rstc RST_SPIFL>;
        pinctrl-names = "default";
        pinctrl-0 = <&spi_flash2_mux &spi_fla4b2_mux>;
        spi-max-frequency = <50000000>;
        spi-chip-selection = <0>;
        read-timing-selection = <1>;
        write-timing-selection = <1>;
    };
...
```

## Documentation/devicetree/bindings/net/sunplus,sp7021-l2sw.txt
```
Sunplus SP7021 dual 10M/100M Ethernet controller (with Layer 2 switch)
----------------------------------------------------------------------

The device node of Sunplus SP7021 Ethernet (L2SW) controller has following
properties.

Required properties:
 - compatible: should be "sunplus,sp7021-l2sw".
 - reg: addresses and length of the register sets for Ethernet controller.
 - reg-names: one name for each entry in the reg property.
 - interrupt-parent: phandle for interrupt parent.
 - interrupts: number and type of interrupt, type should be high-level.
 - clocks: clock selector for Ethernet controller.
 - resets: reset controller selector for Ethernet controller.
 - phy-handle1: handle to node of phy 1 in mdio node.
 - phy-handle2: handle to node of phy 2 in mdio node.
 - pinctrl-names: Names corresponding to the numbered pinctrl states.
 - pinctrl-0: phandle for the 'default' state of pin configuration.
 - nvmem-cell-names: Names corresponding to the nvmem cells of MAC address.
 - nvmem-cells: nvmem cell address of MAC address.
 - mode:
   - 0: daisy-chain mode
   - 1: dual NIC mode
   - 2: daisy-chain mode but disable SA learning

Example:

l2sw: l2sw@0x9c108000 {
	compatible = "sunplus,sp7021-l2sw";
	reg = <0x9c108000 0x400>, <0x9c000280 0x80>;
	reg-names = "l2sw", "moon5";
	interrupt-parent = <&intc>;
	interrupts = <66 IRQ_TYPE_LEVEL_HIGH>;
	clocks = <&clkc L2SW>;
	resets = <&rstc RST_L2SW>;
	phy-handle1 = <&eth_phy0>;
	phy-handle2 = <&eth_phy1>;
	pinctrl-names = "default";
	pinctrl-0 = <&l2sw_demo_board_v3_pins>;
	nvmem-cells = <&mac_addr0>, <&mac_addr1>;
	nvmem-cell-names = "mac_addr0", "mac_addr1";
	mode = < 1 >;
};
```

## Documentation/devicetree/bindings/net/sunplus,sp7021-l2sw.yaml
```yaml
# SPDX-License-Identifier: (GPL-2.0-only OR BSD-2-Clause)
# Copyright (C) Sunplus Co., Ltd. 2021
%YAML 1.2
---
$id: http://devicetree.org/schemas/net/sunplus,sp7021-l2sw.yaml#
$schema: http://devicetree.org/meta-schemas/core.yaml#

title: Sunplus SP7021 Dual Ethernet MAC Device Tree Bindings

maintainers:
  - Wells Lu <wells.lu@sunplus.com>

description: |
  Sunplus SP7021 dual 10M/100M Ethernet MAC controller with Layer 2 switch.
  The controller can operate at either dual Ethernet MAC mode or one Ethernet
  MAC with layer 2 switch (daisy-chain) mode.
  The device node of Sunplus SP7021 Ethernet (L2SW) MAC controller has
  following properties.

properties:
  compatible:
    const: sunplus,sp7021-l2sw

  reg:
    items:
      - description: the L2SW registers.
      - description: the MOON5 registers.

  reg-names:
    items:
      - const: l2sw
      - const: moon5

  interrupts:
    maxItems: 1

  clocks:
    maxItems: 1

  resets:
    maxItems: 1

  phy-handle1:
    description: A handle to node of phy 1 in mdio node
    maxItems: 1

  phy-handle2:
    description: A handle to node of phy 2 in mdio node
    maxItems: 1

  pinctrl-names:
    description: |
      Names corresponding to the numbered pinctrl states.
      A pinctrl state named "default" must be defined.
    const: default

  pinctrl-0:
    description: A handle to the 'default' state of pin configuration

  nvmem-cells:
    items:
      - description: nvmem cell address of MAC address of MAC 1
      - description: nvmem cell address of MAC address of MAC 2

  nvmem-cell-names:
    description: names corresponding to the nvmem cells of MAC address
    items:
      - const: mac_addr0
      - const: mac_addr1

  mode:
    description: |
      Set operating modes of Sunplus Dual Ethernet MAC controller.
      Please set one of the following modes:
        0: daisy-chain mode
        1: dual NIC mode
        2: daisy-chain mode but disable SA learning
    $ref: /schemas/types.yaml#/definitions/uint32
    enum: [ 0, 1, 2 ]

  mdio:
    $ref: mdio.yaml#
    unevaluatedProperties: false

additionalProperties: false

required:
  - compatible
  - reg
  - reg-names
  - interrupts
  - clocks
  - resets
  - phy-handle1
  - phy-handle2
  - pinctrl-names
  - pinctrl-0
  - nvmem-cells
  - nvmem-cell-names
  - mdio

examples:
  - |
    #include <dt-bindings/interrupt-controller/irq.h>
    #include <dt-bindings/clock/sp-sp7021.h>
    #include <dt-bindings/reset/sp-sp7021.h>
    l2sw: l2sw@9c108000 {
        compatible = "sunplus,sp7021-l2sw";
        reg = <0x9c108000 0x400>, <0x9c000280 0x80>;
        reg-names = "l2sw", "moon5";
        interrupt-parent = <&intc>;
        interrupts = <66 IRQ_TYPE_LEVEL_HIGH>;
        clocks = <&clkc L2SW>;
        resets = <&rstc RST_L2SW>;
        phy-handle1 = <&eth_phy0>;
        phy-handle2 = <&eth_phy1>;
        pinctrl-names = "default";
        pinctrl-0 = <&l2sw_demo_board_v3_pins>;
        nvmem-cells = <&mac_addr0>, <&mac_addr1>;
        nvmem-cell-names = "mac_addr0", "mac_addr1";
        mode = < 1 >;

        mdio {
            #address-cells = <1>;
            #size-cells = <0>;
            eth_phy0: ethernet-phy@0 {
                reg = <0>;
            };
            eth_phy1: ethernet-phy@1 {
                reg = <1>;
            };
        };
    };
...
```

## Documentation/devicetree/bindings/nvmem/sunplus,ocotp.txt
```
Device-Tree bindings of sp-ocotp device

Required properties:
- compatible: Should be
				"sunplus,sp7021-ocotp" for sp7021
				"sunplus,q645-ocotp0" for q645
				"sunplus,q645-ocotp1" for q645
				"sunplus,q645-ocotp2" for q645
- reg: Physical base address and length of the controller's register
- clocks: Clock phandles (see clock-controller for details)
- resets: Reset phandles (see reset-controller for details)

/* Data cells */
Child nodes of sp-ocotp, bindings of which as described in
bindings/nvmem/nvmem.txt

Example:

otp: otp@0x9C00AF00 {
	compatible = "sunplus,sp7021-ocotp";
	reg = <0x9C00AF00 0x34>, <0x9C00AF80 0x58>;
	reg-names = "hb_gpio", "otprx";
	clocks = <&clkc OTPRX>;
	resets = <&rstc RST_OTPRX>;

	/* Data cells */
	#address-cells = <1>;
	#size-cells = <1>;
	therm_calib: therm_calib {
		reg = <0x14 0x3>;
	};
	mac_addr0: mac_addr0 {
		reg = <0x34 0x6>;
	};
	mac_addr1: mac_addr1 {
		reg = <0x3A 0x6>;
	};
	disc_vol0: disc_vol0 {
		reg = <0x18 0x2>;
	};
	disc_vol1: disc_vol1 {
		reg = <0x18 0x2>;
	};
};
```

## Documentation/devicetree/bindings/phy/sunplus,sp7021-usb-phy.yaml
```yaml
# SPDX-License-Identifier: (GPL-2.0-only OR BSD-2-Clause)
# Copyright (C) Sunplus Co., Ltd. 2021
%YAML 1.2
---
$id: http://devicetree.org/schemas/phy/sunplus,sp7021-usb-phy.yaml#
$schema: http://devicetree.org/meta-schemas/core.yaml#

title: Sunplus SP7021 USB2 PHY Device Tree bindings for port0/port1

maintainers:
  - Vincent Shih <vincent.shih@sunplus.com>

properties:
  compatible:
    enum:
      - sunplus,sp7021-usb-phy0
      - sunplus,sp7021-usb-phy1

  clocks:
    maxItems: 1

  resets:
    maxItems: 1

  reg:
    maxItems: 3

  interrupts:
    maxItems: 1

  nvmem-cell-names:
    description: names corresponding to the nvmem cells of disconnect voltage
    const: disc_vol

  nvmem-cells:
    description: nvmem cell address of disconnect voltage
    maxItems: 1

required:
  - compatible
  - clocks
  - resets
  - reg
  - interrupts
  - nvmem-cell-names
  - nvmem-cells

additionalProperties: false

examples:
  - |
    #include <dt-bindings/clock/sp-sp7021.h>
    #include <dt-bindings/reset/sp-sp7021.h>
    #include <dt-bindings/interrupt-controller/irq.h>

    sp_uphy0: uphy@9C004A80 {
      compatible = "sunplus,sp7021-usb-phy0";
      clocks = <&clkc UPHY0>;
      resets = <&rstc RST_UPHY0>;
      reg = <0x9C004A80 0x80>, <0x9C000000 0x80>, <0x9C000200 0x80>;
      interrupt-parent = <&intc>;
      interrupts = <36 IRQ_TYPE_LEVEL_HIGH>;
      nvmem-cell-names = "disc_vol";
      nvmem-cells = <&disc_vol>;
    };

    sp_uphy1: uphy@9C004B00 {
      compatible = "sunplus,sp7021-usb-phy1";
      clocks = <&clkc UPHY1>;
      resets = <&rstc RST_UPHY1>;
      reg = <0x9C004B00 0x80>, <0x9C000000 0x80>, <0x9C000200 0x80>;
      interrupt-parent = <&intc>;
      interrupts = <37 IRQ_TYPE_LEVEL_HIGH>;
      nvmem-cell-names = "disc_vol";
      nvmem-cells = <&disc_vol>;
    };
...
```

## Documentation/devicetree/bindings/phy/sunplus,usb2-phy.txt
```
Device-Tree bindings of sp_uphy0/sp_uphy1 device

Required properties:
- compatible: Should be
				"sunplus,sp7021-usb-phy0" for sp_uphy0
				"sunplus,sp7021-usb-phy1" for sp_uphy1
- clocks: Clock phandles (see clock-controller for details)
- resets: Reset phandles (see reset-controller for details)
- reg: Physical base address and length of the controller's register
- interrupt-parent: Interrupt phandles (see interrupt-controller for details)
- interrupts: interrupt number to the cpu.
- nvmem-cell-names : disconnect voltage
- nvmem-cells : reference to an nvmem node for disconnect voltage

Example:

sp_uphy0: uphy@0x9C004A80 {
	compatible = "sunplus,sp7021-usb-phy0";
	clocks = <&clkc UPHY0>;
	resets = <&rstc RST_UPHY0>;
	reg = <0x9C004A80 0x80>, <0x9C000000 0x80>, <0x9C000200 0x80>;
	interrupt-parent = <&intc>;
	interrupts = <36 IRQ_TYPE_LEVEL_HIGH>;
	nvmem-cell-names = "disc_vol0";
	nvmem-cells = <&disc_vol0>;
};

sp_uphy1: uphy@0x9C004B00 {
	compatible = "sunplus,sp7021-usb-phy1";
	clocks = <&clkc UPHY1>;
	resets = <&rstc RST_UPHY1>;
	reg = <0x9C004B00 0x80>, <0x9C000000 0x80>, <0x9C000200 0x80>;
	interrupt-parent = <&intc>;
	interrupts = <37 IRQ_TYPE_LEVEL_HIGH>;
	nvmem-cell-names = "disc_vol1";
	nvmem-cells = <&disc_vol1>;
};
```
